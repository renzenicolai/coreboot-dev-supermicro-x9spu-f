
/* DO NOT EDIT!  This is an autogenerated file.  See scripts/layoutrom.py. */
OUTPUT_FORMAT("elf32-i386")
OUTPUT_ARCH("i386")
SECTIONS
{
_cfunc32flat_tpm_interrupt_handler32 = 0xf18b7 ;
e820_list = 0x6120 ;
_cfunc16_check_irqs = 0x88e9 ;
_cfunc32flat_call32_params_helper = 0xf11c0 ;
MaxPCIBus = 0x60e4 ;
IntelDisplayType = 0x6432 ;
_cfunc32flat_handle_pmm = 0xe9038 ;
ViaFBsize = 0x6438 ;
e820_count = 0x6104 ;
TimerKHz = 0x641c ;
LegacyRamSize = 0x6100 ;
CDRom_locks = 0xf3c0 ;
acpi_pm1a_cnt = 0x6044 ;
FloppyInfo = 0x63a0 ;
ViaRamSpeed = 0x6434 ;
_cfunc32flat_handle_resume32 = 0xf1574 ;
emulated_drive_gf = 0xf3d0 ;
_cfunc32flat_xhci_poll_intr = 0xf1c51 ;
_cfunc32flat_process_op_32 = 0xf11d0 ;
_cfunc16_invoke_mouse_handler = 0xb4b8 ;
mouse_pipe = 0x640c ;
bounce_buf_fl = 0x6468 ;
StackPos = 0xf3f8 ;
DefaultDPTE = 0xf3e8 ;
CanPreempt = 0x6544 ;
entry_elf_ebx = 0xed3d4 ;
VGAHookHandlerType = 0x643c ;
_cfunc32seg_handle_pcibios = 0x6a75 ;
IntelDisplayId = 0x6431 ;
FloppyCount = 0x6540 ;
ShiftTSC = 0x6416 ;
_cfunc16_wait_irq = 0xb139 ;
IDMap = 0x6480 ;
Call16Data = 0xfc04 ;
MainThread = 0x6548 ;
pmode_IDT_info = 0x6598 ;
PirAddr = 0x6048 ;
_cfunc32flat_handle_19 = 0xf188a ;
SmiBootDisplay = 0x6430 ;
CDEmu = 0xf3d4 ;
LastUSBkey = 0xf3a4 ;
keyboard_pipe = 0x6410 ;
_cfunc32seg_handle_apm = 0x6dfe ;
entry_elf_eax = 0xed3d8 ;
HaveRunPost = 0x65a8 ;
rombios32_gdt_48 = 0x6558 ;
_cfunc32flat_yield_preempt = 0xe8d04 ;
Century = 0xf3bc ;
ExtraStack = 0xf400 ;
diskette_param_table2 = 0x63fc ;
rmode_IDT_info = 0x65a0 ;
_cfunc32flat_handle_18 = 0xf185e ;
TimerPort = 0x6418 ;
_cfunc16__farcall16 = 0x85ab ;
Ps2ctr = 0xf3ac ;
FloppyDOR = 0xf3a0 ;
BIOS_CONFIG_TABLE = 0xe6f5 ;
RTCusers = 0xf3b0 ;
cdemu_drive_gf = 0x6464 ;
TimerLast = 0xf3b4 ;
_cfunc32flat_handle_post = 0xf181f ;

    zonelow_base = 0xdd800 ;
    _zonelow_seg = 0xdd80 ;

.text.set_a20 0x70c0 : { *(.text.set_a20) }
.text.set_code_success 0xe3f1 : { *(.text.set_code_success) }
.text.pic_eoi2 0x70ed : { *(.text.pic_eoi2) }
.text.call32_prep 0x70f5 : { *(.text.call32_prep) }
.text.memset 0xe81f : { *(.text.memset) }
.text.enqueue_key 0x718e : { *(.text.enqueue_key) }
.text.kbd_set_flag 0x71ec : { *(.text.kbd_set_flag) }
.text.serial_debug 0xe6ff : { *(.text.serial_debug) }
.text.serial_debug_putc 0x7247 : { *(.text.serial_debug_putc) }
.text.serial_debug_flush 0xe6d7 : { *(.text.serial_debug_flush) }
.text.ehci_reset_pipe 0x7265 : { *(.text.ehci_reset_pipe) }
.text.lba2chs 0x72ac : { *(.text.lba2chs) }
.text.scsi_fill_cmd 0xefdb : { *(.text.scsi_fill_cmd) }
.text.on_extra_stack 0x72f6 : { *(.text.on_extra_stack) }
.text.__stack_hop_back 0x731a : { *(.text.__stack_hop_back) }
.text.default_process_op.isra.2 0x7376 : { *(.text.default_process_op.isra.2) }
.text.getLCHS 0x7397 : { *(.text.getLCHS) }
.text.putsinglehex.isra.13 0x741c : { *(.text.putsinglehex.isra.13) }
.text.puthex.isra.14 0x7433 : { *(.text.puthex.isra.14) }
.text.puts_cs.isra.17 0x74dd : { *(.text.puts_cs.isra.17) }
.text.clear_usertimer 0x74fc : { *(.text.clear_usertimer) }
.text.call32_post 0x7543 : { *(.text.call32_post) }
.text.pci_next 0x75e1 : { *(.text.pci_next) }
.text.rtc_setup 0xfe7e : { *(.text.rtc_setup) }
.text.set_usertimer 0x766d : { *(.text.set_usertimer) }
.text.putuint.isra.16 0x76ef : { *(.text.putuint.isra.16) }
.text.timer_read 0x7738 : { *(.text.timer_read) }
.text.timer_check 0x77e8 : { *(.text.timer_check) }
.text.timer_delay 0x7804 : { *(.text.timer_delay) }
.text.udelay 0xf046 : { *(.text.udelay) }
.text.ndelay.constprop.74 0x7828 : { *(.text.ndelay.constprop.74) }
.text.timer_calc 0x7849 : { *(.text.timer_calc) }
.text.bvprintf.constprop.85 0x7865 : { *(.text.bvprintf.constprop.85) }
.text.panic.constprop.81 0x7af9 : { *(.text.panic.constprop.81) }
.text.__dprintf 0x7b15 : { *(.text.__dprintf) }
.text.dump_regs 0x7b2f : { *(.text.dump_regs) }
.text.__debug_enter 0x7bc6 : { *(.text.__debug_enter) }
.text.__warn_invalid 0x7be8 : { *(.text.__warn_invalid) }
.text.__set_invalid 0x7c0e : { *(.text.__set_invalid) }
.text.getComAddr 0x7c22 : { *(.text.getComAddr) }
.text.getLptAddr 0xff00 : { *(.text.getLptAddr) }
.text.__set_code_invalid 0x7c72 : { *(.text.__set_code_invalid) }
.text.__disk_ret 0x7c98 : { *(.text.__disk_ret) }
.text.disk_1308 0x7cc5 : { *(.text.disk_1308) }
.text.disk_1315 0x7dfc : { *(.text.disk_1315) }
.text.__warn_unimplemented 0x7e6a : { *(.text.__warn_unimplemented) }
.text.__set_code_unimplemented 0x7e90 : { *(.text.__set_code_unimplemented) }
.text.__disk_ret_unimplemented 0x7eb6 : { *(.text.__disk_ret_unimplemented) }
.text.__disk_stub 0x7eda : { *(.text.__disk_stub) }
.text.__warn_timeout 0x7f05 : { *(.text.__warn_timeout) }
.text.i8042_wait_write 0xef0c : { *(.text.i8042_wait_write) }
.text.i8042_command 0xe2e8 : { *(.text.i8042_command) }
.text.floppy_disable_controller 0x7f1b : { *(.text.floppy_disable_controller) }
.text.fill_generic_edd 0xf4f6 : { *(.text.fill_generic_edd) }
.text.fill_edd 0x7f41 : { *(.text.fill_edd) }
.text.handle_12 0x8171 : { *(.text.handle_12) }
.text.handle_11 0x8196 : { *(.text.handle_11) }
.text.handle_05 0x81bb : { *(.text.handle_05) }
.text.handle_10 0xff51 : { *(.text.handle_10) }
.text.handle_02 0x81c4 : { *(.text.handle_02) }
.text.call16_helper 0xfa2e : { *(.text.call16_helper) }
.text.__call32 0x81df : { *(.text.__call32) }
.text.__call32_params.constprop.82 0x824c : { *(.text.__call32_params.constprop.82) }
.text.usb_poll_intr 0x8294 : { *(.text.usb_poll_intr) }
.text._farcall16 0x85ab : { *(.text._farcall16) }
.text.__call16_int 0x85ec : { *(.text.__call16_int) }
.text.handle_75 0xef60 : { *(.text.handle_75) }
.text.disk_1346.isra.50 0x85ff : { *(.text.disk_1346.isra.50) }
.text.process_key 0xf0fc : { *(.text.process_key) }
.text.prockeys 0x86af : { *(.text.prockeys) }
.text.procmodkey 0x8726 : { *(.text.procmodkey) }
.text.ramdisk_copy 0x8780 : { *(.text.ramdisk_copy) }
.text.check_irqs 0x88e9 : { *(.text.check_irqs) }
.text.timer_sleep 0xf818 : { *(.text.timer_sleep) }
.text.rtc_updating 0x890b : { *(.text.rtc_updating) }
.text.ps2_recvbyte 0x8958 : { *(.text.ps2_recvbyte) }
.text.ps2_sendbyte 0x8a29 : { *(.text.ps2_sendbyte) }
.text.ps2_command 0x8ad2 : { *(.text.ps2_command) }
.text.set_leds 0x8dcc : { *(.text.set_leds) }
.text.mouse_command 0xe742 : { *(.text.mouse_command) }
.text.mouse_15c201 0x8e34 : { *(.text.mouse_15c201) }
.text.handle_160a 0x8e8a : { *(.text.handle_160a) }
.text.uhci_waittick 0x8eea : { *(.text.uhci_waittick) }
.text.uhci_send_pipe.constprop.77 0x8f46 : { *(.text.uhci_send_pipe.constprop.77) }
.text.ehci_send_pipe.constprop.78 0x9339 : { *(.text.ehci_send_pipe.constprop.78) }
.text.usb_send_pipe.constprop.76 0x9642 : { *(.text.usb_send_pipe.constprop.76) }
.text.usb_process_op 0x968f : { *(.text.usb_process_op) }
.text.uas_process_op 0x9820 : { *(.text.uas_process_op) }
.text.floppy_wait_irq 0x9a39 : { *(.text.floppy_wait_irq) }
.text.floppy_pio 0xe837 : { *(.text.floppy_pio) }
.text.floppy_enable_controller 0x9aaa : { *(.text.floppy_enable_controller) }
.text.floppy_drive_pio 0x9b02 : { *(.text.floppy_drive_pio) }
.text.floppy_dma_cmd 0x9ba2 : { *(.text.floppy_dma_cmd) }
.text.floppy_drive_readid.constprop.73 0x9cd8 : { *(.text.floppy_drive_readid.constprop.73) }
.text.floppy_prep 0xec62 : { *(.text.floppy_prep) }
.text.floppy_read 0x9d1e : { *(.text.floppy_read) }
.text.floppy_write 0x9ddc : { *(.text.floppy_write) }
.text.floppy_format 0x9e9a : { *(.text.floppy_format) }
.text.megasas_process_op 0xe990 : { *(.text.megasas_process_op) }
.text.await_ide.constprop.75 0x9f27 : { *(.text.await_ide.constprop.75) }
.text.await_not_bsy 0x9f9a : { *(.text.await_not_bsy) }
.text.send_cmd 0x9faa : { *(.text.send_cmd) }
.text.ata_pio_transfer 0xa0b1 : { *(.text.ata_pio_transfer) }
.text.ata_wait_data 0xa21b : { *(.text.ata_wait_data) }
.text.ata_readwrite 0xa285 : { *(.text.ata_readwrite) }
.text.ata_atapi_process_op 0xf869 : { *(.text.ata_atapi_process_op) }
.text.process_op 0xa40f : { *(.text.process_op) }
.text.cdemu_read 0xa7ac : { *(.text.cdemu_read) }
.text.disk_1300 0xa9d5 : { *(.text.disk_1300) }
.text.basic_access 0xaa17 : { *(.text.basic_access) }
.text.disk_1305 0xab76 : { *(.text.disk_1305) }
.text.disk_1310 0xfeae : { *(.text.disk_1310) }
.text.extended_access 0xac8f : { *(.text.extended_access) }
.text.disk_13 0xad7f : { *(.text.disk_13) }
.text.handle_legacy_disk 0xff5d : { *(.text.handle_legacy_disk) }
.text.wait_irq 0xb139 : { *(.text.wait_irq) }
.text.dequeue_key 0xb159 : { *(.text.dequeue_key) }
.text.handle_1553 0xb255 : { *(.text.handle_1553) }
.text.handle_40 0xb3dd : { *(.text.handle_40) }
.text.handle_13 0xb3fc : { *(.text.handle_13) }
.text.handle_76 0xe2b2 : { *(.text.handle_76) }
.text.invoke_mouse_handler 0xb4b8 : { *(.text.invoke_mouse_handler) }
.text.process_mouse 0xb531 : { *(.text.process_mouse) }
.text.handle_16 0xb58c : { *(.text.handle_16) }
.text.handle_1589 0xb6a4 : { *(.text.handle_1589) }
.text.handle_15 0xb741 : { *(.text.handle_15) }
.text.handle_14 0xe079 : { *(.text.handle_14) }
.text.handle_17 0xbfcd : { *(.text.handle_17) }
.text.handle_1a 0xe411 : { *(.text.handle_1a) }
.text.handle_08 0xc153 : { *(.text.handle_08) }
.text.handle_70 0xc465 : { *(.text.handle_70) }
.text.handle_resume 0xc55d : { *(.text.handle_resume) }
.text.handle_pnp 0xc621 : { *(.text.handle_pnp) }
.text.handle_pcibios 0xc66a : { *(.text.handle_pcibios) }
.text.handle_apm 0xf84a : { *(.text.handle_apm) }
.text.handle_hwpic1 0xca2b : { *(.text.handle_hwpic1) }
.text.handle_hwpic2 0xca4d : { *(.text.handle_hwpic2) }
.text.handle_74 0xca6c : { *(.text.handle_74) }
.text.handle_09 0xcaa7 : { *(.text.handle_09) }
.text.handle_0e 0xcaf0 : { *(.text.handle_0e) }
.text.asm.transition32 0xcb0c : { *(.text.asm.transition32) }
.text.asm.transition16 0xcb5a : { *(.text.asm.transition16) }
.text.asm.__farcall16 0xcba8 : { *(.text.asm.__farcall16) }
.text.asm.irq_trampoline_0x02 0xcc35 : { *(.text.asm.irq_trampoline_0x02) }
.text.asm.irq_trampoline_0x05 0xcc38 : { *(.text.asm.irq_trampoline_0x05) }
.text.asm.irq_trampoline_0x10 0xcc3b : { *(.text.asm.irq_trampoline_0x10) }
.text.asm.irq_trampoline_0x13 0xcc3e : { *(.text.asm.irq_trampoline_0x13) }
.text.asm.irq_trampoline_0x15 0xcc41 : { *(.text.asm.irq_trampoline_0x15) }
.text.asm.irq_trampoline_0x16 0xcc44 : { *(.text.asm.irq_trampoline_0x16) }
.text.asm.irq_trampoline_0x18 0xec56 : { *(.text.asm.irq_trampoline_0x18) }
.text.asm.irq_trampoline_0x19 0xe984 : { *(.text.asm.irq_trampoline_0x19) }
.text.asm.irq_trampoline_0x1b 0xe981 : { *(.text.asm.irq_trampoline_0x1b) }
.text.asm.irq_trampoline_0x1c 0xffed : { *(.text.asm.irq_trampoline_0x1c) }
.text.asm.irq_trampoline_0x4a 0xf856 : { *(.text.asm.irq_trampoline_0x4a) }
.text.asm.entry_resume 0xcc47 : { *(.text.asm.entry_resume) }
.text.asm.entry_pmm 0xcc5c : { *(.text.asm.entry_pmm) }
.text.asm.entry_pnp_real 0xccba : { *(.text.asm.entry_pnp_real) }
.text.asm.entry_apm16 0xcd02 : { *(.text.asm.entry_apm16) }
.text.asm.entry_apm32 0xcd43 : { *(.text.asm.entry_apm32) }
.text.asm.entry_pcibios32 0xcd75 : { *(.text.asm.entry_pcibios32) }
.text.asm.entry_pcibios16 0xcda3 : { *(.text.asm.entry_pcibios16) }
.text.asm.entry_1589 0xcddd : { *(.text.asm.entry_1589) }
.text.asm.entry_bios32 0xce17 : { *(.text.asm.entry_bios32) }
.text.asm.entry_elf 0xf06e : { *(.text.asm.entry_elf) }
.text.asm.irqentry_extrastack 0xce36 : { *(.text.asm.irqentry_extrastack) }
.text.asm.irqentry_arg_extrastack 0xcec3 : { *(.text.asm.irqentry_arg_extrastack) }
.text.asm.entry_13 0xcf65 : { *(.text.asm.entry_13) }
.text.asm.entry_76 0xcf6e : { *(.text.asm.entry_76) }
.text.asm.entry_70 0xcf77 : { *(.text.asm.entry_70) }
.text.asm.entry_74 0xcf80 : { *(.text.asm.entry_74) }
.text.asm.entry_75 0xcf89 : { *(.text.asm.entry_75) }
.text.asm.entry_hwpic1 0xcf92 : { *(.text.asm.entry_hwpic1) }
.text.asm.entry_hwpic2 0xcf9b : { *(.text.asm.entry_hwpic2) }
.text.asm.entry_19 0xcfa4 : { *(.text.asm.entry_19) }
.text.asm.entry_18 0xcfb7 : { *(.text.asm.entry_18) }
.rodata 0xcfca : { *(.rodata) }
.rodata.__func__.11538 0xd7b0 : { *(.rodata.__func__.11538) }
.rodata.__func__.10772 0xd7c4 : { *(.rodata.__func__.10772) }
.rodata.__func__.10730 0xd7d0 : { *(.rodata.__func__.10730) }
.rodata.__func__.10398 0xd7dc : { *(.rodata.__func__.10398) }
.rodata.__func__.10378 0xd7e8 : { *(.rodata.__func__.10378) }
.rodata.__func__.9403 0xd7f8 : { *(.rodata.__func__.9403) }
.rodata.__func__.9481 0xd808 : { *(.rodata.__func__.9481) }
.rodata.__func__.7890 0xd818 : { *(.rodata.__func__.7890) }
.rodata.__func__.7983 0xd824 : { *(.rodata.__func__.7983) }
.rodata.__func__.7763 0xd82c : { *(.rodata.__func__.7763) }
.rodata.__func__.6833 0xd83c : { *(.rodata.__func__.6833) }
.rodata.__func__.6894 0xd84c : { *(.rodata.__func__.6894) }
.rodata.__func__.6842 0xd85c : { *(.rodata.__func__.6842) }
.rodata.__func__.6492 0xd870 : { *(.rodata.__func__.6492) }
.rodata.__func__.6396 0xd880 : { *(.rodata.__func__.6396) }
.rodata.__func__.6355 0xd890 : { *(.rodata.__func__.6355) }
.rodata.__func__.6328 0xd8a0 : { *(.rodata.__func__.6328) }
.rodata.__func__.6308 0xd8b0 : { *(.rodata.__func__.6308) }
.rodata.__func__.6121 0xd8c0 : { *(.rodata.__func__.6121) }
.rodata.__func__.6117 0xd8d0 : { *(.rodata.__func__.6117) }
.rodata.__func__.6143 0xd8e0 : { *(.rodata.__func__.6143) }
.rodata.__func__.5989 0xd8ec : { *(.rodata.__func__.5989) }
.rodata.__func__.5982 0xd8fc : { *(.rodata.__func__.5982) }
.rodata.__func__.5971 0xd90c : { *(.rodata.__func__.5971) }
.rodata.__func__.5843 0xd918 : { *(.rodata.__func__.5843) }
.rodata.__func__.5828 0xd924 : { *(.rodata.__func__.5828) }
.rodata.__func__.5815 0xd930 : { *(.rodata.__func__.5815) }
.rodata.__func__.5803 0xd93c : { *(.rodata.__func__.5803) }
.rodata.__func__.5795 0xd948 : { *(.rodata.__func__.5795) }
.rodata.__func__.5724 0xd954 : { *(.rodata.__func__.5724) }
.rodata.__func__.5691 0xd960 : { *(.rodata.__func__.5691) }
.rodata.__func__.5728 0xd96c : { *(.rodata.__func__.5728) }
.rodata.__func__.5660 0xd978 : { *(.rodata.__func__.5660) }
.rodata.__func__.5615 0xd984 : { *(.rodata.__func__.5615) }
.rodata.__func__.5664 0xd990 : { *(.rodata.__func__.5664) }
.rodata.__func__.5570 0xd99c : { *(.rodata.__func__.5570) }
.rodata.__func__.5559 0xd9a8 : { *(.rodata.__func__.5559) }
.rodata.__func__.5555 0xd9b8 : { *(.rodata.__func__.5555) }
.rodata.__func__.5470 0xd9c8 : { *(.rodata.__func__.5470) }
.rodata.__func__.5246 0xd9d8 : { *(.rodata.__func__.5246) }
.rodata.__func__.5007 0xd9e4 : { *(.rodata.__func__.5007) }
.rodata.__func__.4974 0xd9f4 : { *(.rodata.__func__.4974) }
.rodata.__func__.4970 0xda04 : { *(.rodata.__func__.4970) }
.rodata.__func__.4965 0xda14 : { *(.rodata.__func__.4965) }
.rodata.__func__.4960 0xda24 : { *(.rodata.__func__.4960) }
.rodata.__func__.4945 0xda34 : { *(.rodata.__func__.4945) }
.rodata.__func__.4941 0xda44 : { *(.rodata.__func__.4941) }
.rodata.__func__.4933 0xda54 : { *(.rodata.__func__.4933) }
.rodata.__func__.4923 0xda64 : { *(.rodata.__func__.4923) }
.rodata.__func__.4918 0xda74 : { *(.rodata.__func__.4918) }
.rodata.__func__.4905 0xda84 : { *(.rodata.__func__.4905) }
.rodata.__func__.4900 0xda94 : { *(.rodata.__func__.4900) }
.rodata.__func__.4889 0xdaa4 : { *(.rodata.__func__.4889) }
.rodata.__func__.4804 0xdab4 : { *(.rodata.__func__.4804) }
.rodata.__func__.4725 0xdac0 : { *(.rodata.__func__.4725) }
.rodata.__func__.4720 0xdacc : { *(.rodata.__func__.4720) }
.rodata.__func__.4715 0xdad8 : { *(.rodata.__func__.4715) }
.rodata.__func__.4710 0xdae4 : { *(.rodata.__func__.4710) }
.rodata.__func__.4705 0xdaf0 : { *(.rodata.__func__.4705) }
.rodata.__func__.4700 0xdafc : { *(.rodata.__func__.4700) }
.rodata.__func__.4695 0xdb08 : { *(.rodata.__func__.4695) }
.rodata.__func__.4669 0xdb14 : { *(.rodata.__func__.4669) }
.rodata.__func__.4654 0xdb20 : { *(.rodata.__func__.4654) }
.rodata.__func__.4649 0xdb2c : { *(.rodata.__func__.4649) }
.rodata.__func__.4627 0xdb38 : { *(.rodata.__func__.4627) }
.rodata.__func__.4605 0xdb44 : { *(.rodata.__func__.4605) }
.rodata.__func__.4659 0xdb50 : { *(.rodata.__func__.4659) }
.rodata.__func__.4410 0xdb5c : { *(.rodata.__func__.4410) }
.rodata.__func__.4577 0xdb6c : { *(.rodata.__func__.4577) }
.rodata.__func__.4572 0xdb78 : { *(.rodata.__func__.4572) }
.rodata.__func__.4562 0xdb84 : { *(.rodata.__func__.4562) }
.rodata.__func__.4557 0xdb90 : { *(.rodata.__func__.4557) }
.rodata.__func__.4552 0xdb9c : { *(.rodata.__func__.4552) }
.rodata.__func__.4547 0xdba8 : { *(.rodata.__func__.4547) }
.rodata.__func__.4540 0xdbb4 : { *(.rodata.__func__.4540) }
.rodata.__func__.4535 0xdbc0 : { *(.rodata.__func__.4535) }
.rodata.__func__.4530 0xdbcc : { *(.rodata.__func__.4530) }
.rodata.__func__.4508 0xdbd8 : { *(.rodata.__func__.4508) }
.rodata.__func__.4464 0xdbe4 : { *(.rodata.__func__.4464) }
.rodata.__func__.4388 0xdbf0 : { *(.rodata.__func__.4388) }
.rodata.__func__.4432 0xdc00 : { *(.rodata.__func__.4432) }
.rodata.__func__.4740 0xdc0c : { *(.rodata.__func__.4740) }
.rodata.__func__.4809 0xdc18 : { *(.rodata.__func__.4809) }
.rodata.__func__.4816 0xdc2c : { *(.rodata.__func__.4816) }
.rodata.__func__.1906 0xdc38 : { *(.rodata.__func__.1906) }
.rodata.__func__.1893 0xdc44 : { *(.rodata.__func__.1893) }
.rodata.__func__.1885 0xdc50 : { *(.rodata.__func__.1885) }
.rodata.__func__.1876 0xdc5c : { *(.rodata.__func__.1876) }
.rodata.__func__.1867 0xdc68 : { *(.rodata.__func__.1867) }
.data16.. 0xdc80 : { *(.data16..) }
.fixedaddr.0xe05b 0xe05b : { *(.fixedaddr.0xe05b) }
.fixedaddr.0xe2c3 0xe2c3 : { *(.fixedaddr.0xe2c3) }
.fixedaddr.0xe3fe 0xe3fe : { *(.fixedaddr.0xe3fe) }
.fixedaddr.0xe6f2 0xe6f2 : { *(.fixedaddr.0xe6f2) }
.fixedaddr.0xe739 0xe739 : { *(.fixedaddr.0xe739) }
.fixedaddr.0xe82e 0xe82e : { *(.fixedaddr.0xe82e) }
.fixedaddr.0xe987 0xe987 : { *(.fixedaddr.0xe987) }
.fixedaddr.0xec59 0xec59 : { *(.fixedaddr.0xec59) }
.fixedaddr.0xef57 0xef57 : { *(.fixedaddr.0xef57) }
.fixedaddr.0xefd2 0xefd2 : { *(.fixedaddr.0xefd2) }
.fixedaddr.0xf045 0xf045 : { *(.fixedaddr.0xf045) }
.fixedaddr.0xf065 0xf065 : { *(.fixedaddr.0xf065) }
.fixedaddr.0xf841 0xf841 : { *(.fixedaddr.0xf841) }
.fixedaddr.0xf84d 0xf84d : { *(.fixedaddr.0xf84d) }
.fixedaddr.0xf859 0xf859 : { *(.fixedaddr.0xf859) }
.fixedaddr.0xfe6e 0xfe6e : { *(.fixedaddr.0xfe6e) }
.fixedaddr.0xfea5 0xfea5 : { *(.fixedaddr.0xfea5) }
.fixedaddr.0xff53 0xff53 : { *(.fixedaddr.0xff53) }
.fixedaddr.0xff54 0xff54 : { *(.fixedaddr.0xff54) }
.fixedaddr.0xfff0 0xfff0 : { *(.fixedaddr.0xfff0) }



        /* Discard regular data sections to force a link error if
         * code attempts to access data not marked with VAR16 (or other
         * appropriate macro)
         */
        /DISCARD/ : {
                *(.text*) *(.data*) *(.bss*) *(.rodata*)
                *(COMMON) *(.discard*) *(.eh_frame) *(.note*)
                }
}
