
/* DO NOT EDIT!  This is an autogenerated file.  See scripts/layoutrom.py. */
OUTPUT_FORMAT("elf32-i386")
OUTPUT_ARCH("i386")
SECTIONS
{
DefaultDPTE = 0xecbe8 ;
tpm_state = 0xecb84 ;
reply_msg = 0xecb9c ;
emulated_drive_gf = 0xecbd0 ;
Century = 0xecbbc ;
TPM_interface_shutdown = 0xecb80 ;
BootSequence = 0xecb98 ;
StackPos = 0xecbf8 ;
CDEmu = 0xecbd4 ;
Ps2ctr = 0xecbac ;
FloppyDOR = 0xecba0 ;
last_timer_check = 0xecbb8 ;
TPM_working = 0xecb81 ;
CDRom_locks = 0xecbc0 ;
LastUSBkey = 0xecba4 ;
Call16Data = 0xed404 ;
RTCusers = 0xecbb0 ;
ExtraStack = 0xecc00 ;
TimerLast = 0xecbb4 ;
entry_15_official = 0xff859 ;
transition16big = 0xfcb6f ;
entry_13_official = 0xfe3fe ;
irq_trampoline_0x16 = 0xfcc44 ;
irq_trampoline_0x13 = 0xfcc3e ;
entry_1a_official = 0xffe6e ;
irq_trampoline_0x10 = 0xfcc3b ;
entry_17 = 0xfefd2 ;
irq_trampoline_0x19 = 0xfe984 ;
_cfunc16_check_irqs = 0xf88e9 ;
entry_iret_official = 0xfff53 ;
entry_09 = 0xfe987 ;
entry_08 = 0xffea5 ;
entry_pnp_real = 0xfccbe ;
entry_19_official = 0xfe6f2 ;
entry_40 = 0xfec59 ;
entry_02 = 0xfe2c3 ;
_cfunc16_call16_helper = 0xffa2e ;
entry_05 = 0xfff54 ;
entry_74 = 0xfcf80 ;
irq_trampoline_0x18 = 0xfec56 ;
_cfunc16_wait_irq = 0xfb139 ;
reset_vector = 0xffff0 ;
transition16 = 0xfcb5a ;
entry_pnp_prot = 0xfccba ;
entry_70 = 0xfcf77 ;
entry_76 = 0xfcf6e ;
entry_pmm = 0xfcc5c ;
entry_75 = 0xfcf89 ;
entry_18 = 0xfcfb7 ;
entry_bios32 = 0xfce17 ;
_cfunc16__farcall16 = 0xf85ab ;
entry_11 = 0xff84d ;
entry_12 = 0xff841 ;
entry_14 = 0xfe739 ;
entry_16 = 0xfe82e ;
entry_elf = 0xff06e ;
entry_10 = 0xff065 ;
transition32_nmi_off = 0xfcb24 ;
entry_hwpic1 = 0xfcf92 ;
entry_hwpic2 = 0xfcf9b ;
entry_0e = 0xfef57 ;

    _reloc_min_align = 0x20 ;
    zonefseg_start = 0xf5840 ;
    zonefseg_end = 0xf6040 ;
    zonelow_base = 0xdd800 ;
    final_varlow_start = 0xecb80 ;
    final_readonly_start = 0xed420 ;
    varlow_start = 0xe0160 ;
    varlow_end = 0xe0a00 ;
    code32init_start = 0xe0a00 ;
    code32init_end = 0xed420 ;

    code32flat_start = 0xdf2a0 ;
    .text code32flat_start : {
LONG(0x1BADB002) LONG(0) LONG(-0x1BADB002)
        _reloc_abs_start = ABSOLUTE(.) ;
LONG(0xe0d1d - code32init_start)
LONG(0xe0d57 - code32init_start)
LONG(0xe0d60 - code32init_start)
LONG(0xe0dd5 - code32init_start)
LONG(0xe0e09 - code32init_start)
LONG(0xe0e12 - code32init_start)
LONG(0xe0e45 - code32init_start)
LONG(0xe0e4e - code32init_start)
LONG(0xe0e96 - code32init_start)
LONG(0xe115c - code32init_start)
LONG(0xe116c - code32init_start)
LONG(0xe1177 - code32init_start)
LONG(0xe11a6 - code32init_start)
LONG(0xe19b3 - code32init_start)
LONG(0xe1a24 - code32init_start)
LONG(0xe1a67 - code32init_start)
LONG(0xe1a7a - code32init_start)
LONG(0xe1af2 - code32init_start)
LONG(0xe1fe6 - code32init_start)
LONG(0xe2013 - code32init_start)
LONG(0xe2063 - code32init_start)
LONG(0xe20e6 - code32init_start)
LONG(0xe2100 - code32init_start)
LONG(0xe210f - code32init_start)
LONG(0xe21f1 - code32init_start)
LONG(0xe227b - code32init_start)
LONG(0xe22f2 - code32init_start)
LONG(0xe2394 - code32init_start)
LONG(0xe2404 - code32init_start)
LONG(0xe2412 - code32init_start)
LONG(0xe24a7 - code32init_start)
LONG(0xe24af - code32init_start)
LONG(0xe24cc - code32init_start)
LONG(0xe24d2 - code32init_start)
LONG(0xe2568 - code32init_start)
LONG(0xe25a8 - code32init_start)
LONG(0xe25ca - code32init_start)
LONG(0xe2662 - code32init_start)
LONG(0xe2792 - code32init_start)
LONG(0xe2a36 - code32init_start)
LONG(0xe2a47 - code32init_start)
LONG(0xe2a6b - code32init_start)
LONG(0xe2a8f - code32init_start)
LONG(0xe2aae - code32init_start)
LONG(0xe2aff - code32init_start)
LONG(0xe2b10 - code32init_start)
LONG(0xe2b22 - code32init_start)
LONG(0xe2b34 - code32init_start)
LONG(0xe2b68 - code32init_start)
LONG(0xe2b76 - code32init_start)
LONG(0xe2bb6 - code32init_start)
LONG(0xe2c40 - code32init_start)
LONG(0xe2c68 - code32init_start)
LONG(0xe2cb3 - code32init_start)
LONG(0xe2ceb - code32init_start)
LONG(0xe2d0e - code32init_start)
LONG(0xe2d32 - code32init_start)
LONG(0xe2d74 - code32init_start)
LONG(0xe2dae - code32init_start)
LONG(0xe2db6 - code32init_start)
LONG(0xe2e93 - code32init_start)
LONG(0xe2ecc - code32init_start)
LONG(0xe305d - code32init_start)
LONG(0xe30e0 - code32init_start)
LONG(0xe30f9 - code32init_start)
LONG(0xe3101 - code32init_start)
LONG(0xe3142 - code32init_start)
LONG(0xe326f - code32init_start)
LONG(0xe3537 - code32init_start)
LONG(0xe3583 - code32init_start)
LONG(0xe366a - code32init_start)
LONG(0xe3712 - code32init_start)
LONG(0xe3796 - code32init_start)
LONG(0xe37e2 - code32init_start)
LONG(0xe3855 - code32init_start)
LONG(0xe389f - code32init_start)
LONG(0xe38af - code32init_start)
LONG(0xe3963 - code32init_start)
LONG(0xe39ae - code32init_start)
LONG(0xe3ab7 - code32init_start)
LONG(0xe3b14 - code32init_start)
LONG(0xe3c3f - code32init_start)
LONG(0xe3c85 - code32init_start)
LONG(0xe3cfd - code32init_start)
LONG(0xe3dc9 - code32init_start)
LONG(0xe3e6e - code32init_start)
LONG(0xe3e9c - code32init_start)
LONG(0xe3f65 - code32init_start)
LONG(0xe4003 - code32init_start)
LONG(0xe4094 - code32init_start)
LONG(0xe40ea - code32init_start)
LONG(0xe42a6 - code32init_start)
LONG(0xe442b - code32init_start)
LONG(0xe465d - code32init_start)
LONG(0xe4732 - code32init_start)
LONG(0xe4750 - code32init_start)
LONG(0xe4782 - code32init_start)
LONG(0xe48c2 - code32init_start)
LONG(0xe48c9 - code32init_start)
LONG(0xe48d9 - code32init_start)
LONG(0xe4987 - code32init_start)
LONG(0xe49a5 - code32init_start)
LONG(0xe4a06 - code32init_start)
LONG(0xe4b0f - code32init_start)
LONG(0xe4bc3 - code32init_start)
LONG(0xe4bf2 - code32init_start)
LONG(0xe4c26 - code32init_start)
LONG(0xe4c86 - code32init_start)
LONG(0xe4caf - code32init_start)
LONG(0xe4ce5 - code32init_start)
LONG(0xe4d0e - code32init_start)
LONG(0xe4d41 - code32init_start)
LONG(0xe4d84 - code32init_start)
LONG(0xe4ddb - code32init_start)
LONG(0xe4e05 - code32init_start)
LONG(0xe4e74 - code32init_start)
LONG(0xe4e97 - code32init_start)
LONG(0xe4eb4 - code32init_start)
LONG(0xe4f49 - code32init_start)
LONG(0xe4f83 - code32init_start)
LONG(0xe4f8d - code32init_start)
LONG(0xe4f9f - code32init_start)
LONG(0xe4fc5 - code32init_start)
LONG(0xe506d - code32init_start)
LONG(0xe50bc - code32init_start)
LONG(0xe51c5 - code32init_start)
LONG(0xe5207 - code32init_start)
LONG(0xe520d - code32init_start)
LONG(0xe5220 - code32init_start)
LONG(0xe5230 - code32init_start)
LONG(0xe529f - code32init_start)
LONG(0xe5343 - code32init_start)
LONG(0xe5382 - code32init_start)
LONG(0xe55da - code32init_start)
LONG(0xe5606 - code32init_start)
LONG(0xe560b - code32init_start)
LONG(0xe5618 - code32init_start)
LONG(0xe5621 - code32init_start)
LONG(0xe5638 - code32init_start)
LONG(0xe5650 - code32init_start)
LONG(0xe57b7 - code32init_start)
LONG(0xe58ee - code32init_start)
LONG(0xe5a8d - code32init_start)
LONG(0xe5a96 - code32init_start)
LONG(0xe5b04 - code32init_start)
LONG(0xe5b0d - code32init_start)
LONG(0xe5b66 - code32init_start)
LONG(0xe5e33 - code32init_start)
LONG(0xe5e4a - code32init_start)
LONG(0xe5f6a - code32init_start)
LONG(0xe60f6 - code32init_start)
LONG(0xe6472 - code32init_start)
LONG(0xe651a - code32init_start)
LONG(0xe652b - code32init_start)
LONG(0xe653c - code32init_start)
LONG(0xe65ff - code32init_start)
LONG(0xe67b0 - code32init_start)
LONG(0xe6873 - code32init_start)
LONG(0xe6878 - code32init_start)
LONG(0xe68c5 - code32init_start)
LONG(0xe69b6 - code32init_start)
LONG(0xe69cd - code32init_start)
LONG(0xe6a87 - code32init_start)
LONG(0xe6b5b - code32init_start)
LONG(0xe6bf5 - code32init_start)
LONG(0xe6bfa - code32init_start)
LONG(0xe6c4a - code32init_start)
LONG(0xe6da3 - code32init_start)
LONG(0xe6db8 - code32init_start)
LONG(0xe6e0a - code32init_start)
LONG(0xe6e50 - code32init_start)
LONG(0xe6e6a - code32init_start)
LONG(0xe6e82 - code32init_start)
LONG(0xe6ed3 - code32init_start)
LONG(0xe6f4f - code32init_start)
LONG(0xe6f67 - code32init_start)
LONG(0xe6fae - code32init_start)
LONG(0xe6ffe - code32init_start)
LONG(0xe705e - code32init_start)
LONG(0xe7105 - code32init_start)
LONG(0xe710a - code32init_start)
LONG(0xe7118 - code32init_start)
LONG(0xe719d - code32init_start)
LONG(0xe71f8 - code32init_start)
LONG(0xe7299 - code32init_start)
LONG(0xe72f4 - code32init_start)
LONG(0xe7350 - code32init_start)
LONG(0xe7389 - code32init_start)
LONG(0xe73d6 - code32init_start)
LONG(0xe73f3 - code32init_start)
LONG(0xe7445 - code32init_start)
LONG(0xe74a7 - code32init_start)
LONG(0xe7612 - code32init_start)
LONG(0xe7622 - code32init_start)
LONG(0xe773c - code32init_start)
LONG(0xe77e9 - code32init_start)
LONG(0xe787e - code32init_start)
LONG(0xe7922 - code32init_start)
LONG(0xe7958 - code32init_start)
LONG(0xe79af - code32init_start)
LONG(0xe79d7 - code32init_start)
LONG(0xe7dce - code32init_start)
LONG(0xe7df2 - code32init_start)
LONG(0xe7e2f - code32init_start)
LONG(0xe7e42 - code32init_start)
LONG(0xe7e5b - code32init_start)
LONG(0xe7f6d - code32init_start)
LONG(0xe805e - code32init_start)
LONG(0xe808f - code32init_start)
LONG(0xe8279 - code32init_start)
LONG(0xe86a8 - code32init_start)
LONG(0xe87fa - code32init_start)
LONG(0xe8bc3 - code32init_start)
LONG(0xe8c59 - code32init_start)
LONG(0xe8da0 - code32init_start)
LONG(0xe8e4f - code32init_start)
LONG(0xe8e5c - code32init_start)
LONG(0xe8eec - code32init_start)
LONG(0xe8f02 - code32init_start)
LONG(0xe8f4b - code32init_start)
LONG(0xe8ff7 - code32init_start)
LONG(0xe900c - code32init_start)
LONG(0xe90b0 - code32init_start)
LONG(0xe90b5 - code32init_start)
LONG(0xe90bc - code32init_start)
LONG(0xe90c1 - code32init_start)
LONG(0xe91b1 - code32init_start)
LONG(0xe9436 - code32init_start)
LONG(0xe9520 - code32init_start)
LONG(0xe9571 - code32init_start)
LONG(0xe9582 - code32init_start)
LONG(0xe98cf - code32init_start)
LONG(0xe9a77 - code32init_start)
LONG(0xe9b9a - code32init_start)
LONG(0xe9d40 - code32init_start)
LONG(0xe9f1e - code32init_start)
LONG(0xea207 - code32init_start)
LONG(0xea222 - code32init_start)
LONG(0xea245 - code32init_start)
LONG(0xea2b3 - code32init_start)
LONG(0xea2e5 - code32init_start)
LONG(0xea31e - code32init_start)
LONG(0xea42c - code32init_start)
LONG(0xea444 - code32init_start)
LONG(0xea461 - code32init_start)
LONG(0xea55d - code32init_start)
LONG(0xea94b - code32init_start)
LONG(0xeab89 - code32init_start)
LONG(0xebb25 - code32init_start)
LONG(0xebb2e - code32init_start)
LONG(0xebb60 - code32init_start)
LONG(0xebec1 - code32init_start)
LONG(0xec147 - code32init_start)
LONG(0xec170 - code32init_start)
LONG(0xec194 - code32init_start)
LONG(0xec1a4 - code32init_start)
LONG(0xec354 - code32init_start)
LONG(0xec394 - code32init_start)
LONG(0xec74d - code32init_start)
LONG(0xec78a - code32init_start)
LONG(0xec7ab - code32init_start)
LONG(0xec80c - code32init_start)
LONG(0xec81d - code32init_start)
LONG(0xec86d - code32init_start)
LONG(0xec898 - code32init_start)
LONG(0xec8a7 - code32init_start)
LONG(0xec934 - code32init_start)
LONG(0xec998 - code32init_start)
LONG(0xec9d5 - code32init_start)
LONG(0xeca0e - code32init_start)
LONG(0xecbd8 - code32init_start)
LONG(0xecc10 - code32init_start)
LONG(0xecc14 - code32init_start)
LONG(0xecc18 - code32init_start)
LONG(0xecc1c - code32init_start)
LONG(0xecc20 - code32init_start)
LONG(0xecc24 - code32init_start)
LONG(0xecc28 - code32init_start)
LONG(0xecc2c - code32init_start)
LONG(0xecc30 - code32init_start)
LONG(0xed2b0 - code32init_start)
LONG(0xed2c4 - code32init_start)
LONG(0xed2f4 - code32init_start)
LONG(0xed2f8 - code32init_start)
LONG(0xed2fc - code32init_start)
LONG(0xed300 - code32init_start)
LONG(0xed304 - code32init_start)
LONG(0xed308 - code32init_start)
LONG(0xed31c - code32init_start)
LONG(0xed320 - code32init_start)
LONG(0xed324 - code32init_start)
LONG(0xed328 - code32init_start)
LONG(0xed32c - code32init_start)
LONG(0xed3a8 - code32init_start)
LONG(0xed3ac - code32init_start)
LONG(0xed3b0 - code32init_start)
LONG(0xed3b4 - code32init_start)
LONG(0xed3b8 - code32init_start)
LONG(0xed3bc - code32init_start)
LONG(0xed3c0 - code32init_start)
LONG(0xed3c4 - code32init_start)
LONG(0xed3c8 - code32init_start)
        _reloc_abs_end = ABSOLUTE(.) ;
        _reloc_rel_start = ABSOLUTE(.) ;
LONG(0xe0a72 - code32init_start)
LONG(0xe0dcd - code32init_start)
LONG(0xe1390 - code32init_start)
LONG(0xe1429 - code32init_start)
LONG(0xe1ac0 - code32init_start)
LONG(0xe1ae9 - code32init_start)
LONG(0xe1c50 - code32init_start)
LONG(0xe1c60 - code32init_start)
LONG(0xe1c79 - code32init_start)
LONG(0xe1c89 - code32init_start)
LONG(0xe1c8f - code32init_start)
LONG(0xe1cb3 - code32init_start)
LONG(0xe1ce8 - code32init_start)
LONG(0xe1cf1 - code32init_start)
LONG(0xe1cfa - code32init_start)
LONG(0xe1db9 - code32init_start)
LONG(0xe1e06 - code32init_start)
LONG(0xe1e20 - code32init_start)
LONG(0xe1e37 - code32init_start)
LONG(0xe1e4e - code32init_start)
LONG(0xe1e60 - code32init_start)
LONG(0xe1e89 - code32init_start)
LONG(0xe1ebb - code32init_start)
LONG(0xe1ece - code32init_start)
LONG(0xe1ee8 - code32init_start)
LONG(0xe1efc - code32init_start)
LONG(0xe1f0d - code32init_start)
LONG(0xe1f5d - code32init_start)
LONG(0xe1fcc - code32init_start)
LONG(0xe1ff1 - code32init_start)
LONG(0xe201d - code32init_start)
LONG(0xe2074 - code32init_start)
LONG(0xe2119 - code32init_start)
LONG(0xe21ce - code32init_start)
LONG(0xe21e8 - code32init_start)
LONG(0xe21fb - code32init_start)
LONG(0xe2213 - code32init_start)
LONG(0xe2241 - code32init_start)
LONG(0xe2251 - code32init_start)
LONG(0xe226a - code32init_start)
LONG(0xe2271 - code32init_start)
LONG(0xe2285 - code32init_start)
LONG(0xe228c - code32init_start)
LONG(0xe229e - code32init_start)
LONG(0xe22ac - code32init_start)
LONG(0xe22c0 - code32init_start)
LONG(0xe22d8 - code32init_start)
LONG(0xe22e9 - code32init_start)
LONG(0xe22fc - code32init_start)
LONG(0xe2306 - code32init_start)
LONG(0xe2323 - code32init_start)
LONG(0xe2328 - code32init_start)
LONG(0xe2353 - code32init_start)
LONG(0xe2376 - code32init_start)
LONG(0xe238c - code32init_start)
LONG(0xe239e - code32init_start)
LONG(0xe23b9 - code32init_start)
LONG(0xe23cb - code32init_start)
LONG(0xe23f7 - code32init_start)
LONG(0xe2409 - code32init_start)
LONG(0xe241c - code32init_start)
LONG(0xe2426 - code32init_start)
LONG(0xe243a - code32init_start)
LONG(0xe246f - code32init_start)
LONG(0xe24a2 - code32init_start)
LONG(0xe24c6 - code32init_start)
LONG(0xe2572 - code32init_start)
LONG(0xe2587 - code32init_start)
LONG(0xe259f - code32init_start)
LONG(0xe25b2 - code32init_start)
LONG(0xe25b9 - code32init_start)
LONG(0xe25dc - code32init_start)
LONG(0xe2608 - code32init_start)
LONG(0xe2620 - code32init_start)
LONG(0xe266c - code32init_start)
LONG(0xe26a1 - code32init_start)
LONG(0xe26b3 - code32init_start)
LONG(0xe26db - code32init_start)
LONG(0xe272f - code32init_start)
LONG(0xe274b - code32init_start)
LONG(0xe2786 - code32init_start)
LONG(0xe279c - code32init_start)
LONG(0xe27f5 - code32init_start)
LONG(0xe2a0d - code32init_start)
LONG(0xe2a75 - code32init_start)
LONG(0xe2ab8 - code32init_start)
LONG(0xe2aca - code32init_start)
LONG(0xe2b80 - code32init_start)
LONG(0xe2b92 - code32init_start)
LONG(0xe2c7e - code32init_start)
LONG(0xe2cf0 - code32init_start)
LONG(0xe2d18 - code32init_start)
LONG(0xe2d26 - code32init_start)
LONG(0xe2d45 - code32init_start)
LONG(0xe2d83 - code32init_start)
LONG(0xe2da9 - code32init_start)
LONG(0xe2e51 - code32init_start)
LONG(0xe2e61 - code32init_start)
LONG(0xe2ed6 - code32init_start)
LONG(0xe2ee7 - code32init_start)
LONG(0xe2fd6 - code32init_start)
LONG(0xe301c - code32init_start)
LONG(0xe3044 - code32init_start)
LONG(0xe3067 - code32init_start)
LONG(0xe3077 - code32init_start)
LONG(0xe30f1 - code32init_start)
LONG(0xe313b - code32init_start)
LONG(0xe3168 - code32init_start)
LONG(0xe3178 - code32init_start)
LONG(0xe31a5 - code32init_start)
LONG(0xe31ca - code32init_start)
LONG(0xe31d8 - code32init_start)
LONG(0xe31ec - code32init_start)
LONG(0xe320a - code32init_start)
LONG(0xe322a - code32init_start)
LONG(0xe324c - code32init_start)
LONG(0xe325c - code32init_start)
LONG(0xe3266 - code32init_start)
LONG(0xe3279 - code32init_start)
LONG(0xe3283 - code32init_start)
LONG(0xe32a5 - code32init_start)
LONG(0xe32b0 - code32init_start)
LONG(0xe32b5 - code32init_start)
LONG(0xe32ff - code32init_start)
LONG(0xe3325 - code32init_start)
LONG(0xe3345 - code32init_start)
LONG(0xe34e3 - code32init_start)
LONG(0xe34fd - code32init_start)
LONG(0xe351b - code32init_start)
LONG(0xe352c - code32init_start)
LONG(0xe3553 - code32init_start)
LONG(0xe3572 - code32init_start)
LONG(0xe358d - code32init_start)
LONG(0xe35e9 - code32init_start)
LONG(0xe3602 - code32init_start)
LONG(0xe364e - code32init_start)
LONG(0xe3674 - code32init_start)
LONG(0xe368e - code32init_start)
LONG(0xe36ad - code32init_start)
LONG(0xe371c - code32init_start)
LONG(0xe372d - code32init_start)
LONG(0xe37b0 - code32init_start)
LONG(0xe37b7 - code32init_start)
LONG(0xe37d3 - code32init_start)
LONG(0xe37ec - code32init_start)
LONG(0xe385f - code32init_start)
LONG(0xe387b - code32init_start)
LONG(0xe3896 - code32init_start)
LONG(0xe38a9 - code32init_start)
LONG(0xe38b9 - code32init_start)
LONG(0xe38d3 - code32init_start)
LONG(0xe391c - code32init_start)
LONG(0xe399b - code32init_start)
LONG(0xe39ca - code32init_start)
LONG(0xe39f1 - code32init_start)
LONG(0xe3ac1 - code32init_start)
LONG(0xe3ad9 - code32init_start)
LONG(0xe3ae8 - code32init_start)
LONG(0xe3af7 - code32init_start)
LONG(0xe3b06 - code32init_start)
LONG(0xe3b1e - code32init_start)
LONG(0xe3c49 - code32init_start)
LONG(0xe3c8f - code32init_start)
LONG(0xe3ceb - code32init_start)
LONG(0xe3d15 - code32init_start)
LONG(0xe3dd3 - code32init_start)
LONG(0xe3de6 - code32init_start)
LONG(0xe3e02 - code32init_start)
LONG(0xe3e1c - code32init_start)
LONG(0xe3e76 - code32init_start)
LONG(0xe3e88 - code32init_start)
LONG(0xe3eb8 - code32init_start)
LONG(0xe3ee4 - code32init_start)
LONG(0xe3f6f - code32init_start)
LONG(0xe3f82 - code32init_start)
LONG(0xe3f90 - code32init_start)
LONG(0xe3fdd - code32init_start)
LONG(0xe3ffa - code32init_start)
LONG(0xe400d - code32init_start)
LONG(0xe409c - code32init_start)
LONG(0xe40d4 - code32init_start)
LONG(0xe4105 - code32init_start)
LONG(0xe4128 - code32init_start)
LONG(0xe4223 - code32init_start)
LONG(0xe42b0 - code32init_start)
LONG(0xe42ce - code32init_start)
LONG(0xe43e7 - code32init_start)
LONG(0xe4441 - code32init_start)
LONG(0xe44c6 - code32init_start)
LONG(0xe4556 - code32init_start)
LONG(0xe461c - code32init_start)
LONG(0xe467e - code32init_start)
LONG(0xe46e9 - code32init_start)
LONG(0xe478c - code32init_start)
LONG(0xe47af - code32init_start)
LONG(0xe47bc - code32init_start)
LONG(0xe47c9 - code32init_start)
LONG(0xe4889 - code32init_start)
LONG(0xe48ef - code32init_start)
LONG(0xe4991 - code32init_start)
LONG(0xe49be - code32init_start)
LONG(0xe4a10 - code32init_start)
LONG(0xe4a23 - code32init_start)
LONG(0xe4b19 - code32init_start)
LONG(0xe4bfc - code32init_start)
LONG(0xe4c30 - code32init_start)
LONG(0xe4c3d - code32init_start)
LONG(0xe4c90 - code32init_start)
LONG(0xe4cb9 - code32init_start)
LONG(0xe4cef - code32init_start)
LONG(0xe4d18 - code32init_start)
LONG(0xe4d8e - code32init_start)
LONG(0xe4de5 - code32init_start)
LONG(0xe4e0f - code32init_start)
LONG(0xe4e7e - code32init_start)
LONG(0xe4ea1 - code32init_start)
LONG(0xe4ebe - code32init_start)
LONG(0xe4ef6 - code32init_start)
LONG(0xe4f40 - code32init_start)
LONG(0xe4fb6 - code32init_start)
LONG(0xe4fe8 - code32init_start)
LONG(0xe5009 - code32init_start)
LONG(0xe501c - code32init_start)
LONG(0xe5024 - code32init_start)
LONG(0xe502e - code32init_start)
LONG(0xe5077 - code32init_start)
LONG(0xe5088 - code32init_start)
LONG(0xe50a0 - code32init_start)
LONG(0xe50c4 - code32init_start)
LONG(0xe50d4 - code32init_start)
LONG(0xe50ed - code32init_start)
LONG(0xe511b - code32init_start)
LONG(0xe51cf - code32init_start)
LONG(0xe5217 - code32init_start)
LONG(0xe523b - code32init_start)
LONG(0xe524e - code32init_start)
LONG(0xe52a9 - code32init_start)
LONG(0xe52bd - code32init_start)
LONG(0xe52cd - code32init_start)
LONG(0xe5323 - code32init_start)
LONG(0xe534d - code32init_start)
LONG(0xe53a5 - code32init_start)
LONG(0xe5546 - code32init_start)
LONG(0xe5557 - code32init_start)
LONG(0xe557a - code32init_start)
LONG(0xe562b - code32init_start)
LONG(0xe5648 - code32init_start)
LONG(0xe5684 - code32init_start)
LONG(0xe5695 - code32init_start)
LONG(0xe56ae - code32init_start)
LONG(0xe56be - code32init_start)
LONG(0xe56e1 - code32init_start)
LONG(0xe56f1 - code32init_start)
LONG(0xe5716 - code32init_start)
LONG(0xe5726 - code32init_start)
LONG(0xe575b - code32init_start)
LONG(0xe57c1 - code32init_start)
LONG(0xe58b9 - code32init_start)
LONG(0xe58c9 - code32init_start)
LONG(0xe58e8 - code32init_start)
LONG(0xe5a1d - code32init_start)
LONG(0xe5a62 - code32init_start)
LONG(0xe5a85 - code32init_start)
LONG(0xe5aa6 - code32init_start)
LONG(0xe5ac5 - code32init_start)
LONG(0xe5b1d - code32init_start)
LONG(0xe5b35 - code32init_start)
LONG(0xe5b44 - code32init_start)
LONG(0xe5b7f - code32init_start)
LONG(0xe5e3d - code32init_start)
LONG(0xe5e64 - code32init_start)
LONG(0xe5eac - code32init_start)
LONG(0xe5eb8 - code32init_start)
LONG(0xe5f14 - code32init_start)
LONG(0xe5f74 - code32init_start)
LONG(0xe5f8b - code32init_start)
LONG(0xe5fe1 - code32init_start)
LONG(0xe6015 - code32init_start)
LONG(0xe6070 - code32init_start)
LONG(0xe6097 - code32init_start)
LONG(0xe60c5 - code32init_start)
LONG(0xe60ed - code32init_start)
LONG(0xe6100 - code32init_start)
LONG(0xe613c - code32init_start)
LONG(0xe61a5 - code32init_start)
LONG(0xe61e0 - code32init_start)
LONG(0xe6232 - code32init_start)
LONG(0xe62dc - code32init_start)
LONG(0xe63bc - code32init_start)
LONG(0xe6422 - code32init_start)
LONG(0xe6453 - code32init_start)
LONG(0xe64c5 - code32init_start)
LONG(0xe64db - code32init_start)
LONG(0xe6503 - code32init_start)
LONG(0xe6524 - code32init_start)
LONG(0xe65c5 - code32init_start)
LONG(0xe6621 - code32init_start)
LONG(0xe6636 - code32init_start)
LONG(0xe6687 - code32init_start)
LONG(0xe66e8 - code32init_start)
LONG(0xe66ff - code32init_start)
LONG(0xe6735 - code32init_start)
LONG(0xe676b - code32init_start)
LONG(0xe677e - code32init_start)
LONG(0xe67ba - code32init_start)
LONG(0xe67cd - code32init_start)
LONG(0xe685b - code32init_start)
LONG(0xe686d - code32init_start)
LONG(0xe68d2 - code32init_start)
LONG(0xe6b3c - code32init_start)
LONG(0xe6b65 - code32init_start)
LONG(0xe6bdf - code32init_start)
LONG(0xe6c54 - code32init_start)
LONG(0xe6c65 - code32init_start)
LONG(0xe6ce7 - code32init_start)
LONG(0xe6d10 - code32init_start)
LONG(0xe6d70 - code32init_start)
LONG(0xe6d81 - code32init_start)
LONG(0xe6e14 - code32init_start)
LONG(0xe6e22 - code32init_start)
LONG(0xe6e5c - code32init_start)
LONG(0xe6edd - code32init_start)
LONG(0xe6eeb - code32init_start)
LONG(0xe6f02 - code32init_start)
LONG(0xe6f3a - code32init_start)
LONG(0xe6fb8 - code32init_start)
LONG(0xe6fc6 - code32init_start)
LONG(0xe6fdc - code32init_start)
LONG(0xe701b - code32init_start)
LONG(0xe7091 - code32init_start)
LONG(0xe70f6 - code32init_start)
LONG(0xe7100 - code32init_start)
LONG(0xe7198 - code32init_start)
LONG(0xe7202 - code32init_start)
LONG(0xe7236 - code32init_start)
LONG(0xe726d - code32init_start)
LONG(0xe72fe - code32init_start)
LONG(0xe730c - code32init_start)
LONG(0xe731b - code32init_start)
LONG(0xe732a - code32init_start)
LONG(0xe7338 - code32init_start)
LONG(0xe7349 - code32init_start)
LONG(0xe73c0 - code32init_start)
LONG(0xe7435 - code32init_start)
LONG(0xe7440 - code32init_start)
LONG(0xe74be - code32init_start)
LONG(0xe752f - code32init_start)
LONG(0xe7550 - code32init_start)
LONG(0xe7599 - code32init_start)
LONG(0xe762c - code32init_start)
LONG(0xe767a - code32init_start)
LONG(0xe76df - code32init_start)
LONG(0xe76e4 - code32init_start)
LONG(0xe770b - code32init_start)
LONG(0xe7750 - code32init_start)
LONG(0xe77d3 - code32init_start)
LONG(0xe77f3 - code32init_start)
LONG(0xe7801 - code32init_start)
LONG(0xe7837 - code32init_start)
LONG(0xe786a - code32init_start)
LONG(0xe7888 - code32init_start)
LONG(0xe7899 - code32init_start)
LONG(0xe78b2 - code32init_start)
LONG(0xe78eb - code32init_start)
LONG(0xe7901 - code32init_start)
LONG(0xe792c - code32init_start)
LONG(0xe793e - code32init_start)
LONG(0xe796f - code32init_start)
LONG(0xe7999 - code32init_start)
LONG(0xe79b9 - code32init_start)
LONG(0xe79c7 - code32init_start)
LONG(0xe79e7 - code32init_start)
LONG(0xe79fe - code32init_start)
LONG(0xe7a12 - code32init_start)
LONG(0xe7b0a - code32init_start)
LONG(0xe7b9b - code32init_start)
LONG(0xe7ba7 - code32init_start)
LONG(0xe7bea - code32init_start)
LONG(0xe7bfd - code32init_start)
LONG(0xe7c06 - code32init_start)
LONG(0xe7d5a - code32init_start)
LONG(0xe7d8f - code32init_start)
LONG(0xe7dda - code32init_start)
LONG(0xe7dfe - code32init_start)
LONG(0xe7e39 - code32init_start)
LONG(0xe7e4e - code32init_start)
LONG(0xe7ea5 - code32init_start)
LONG(0xe7ec1 - code32init_start)
LONG(0xe7eff - code32init_start)
LONG(0xe7f1a - code32init_start)
LONG(0xe7f79 - code32init_start)
LONG(0xe7f87 - code32init_start)
LONG(0xe7fa1 - code32init_start)
LONG(0xe7ff4 - code32init_start)
LONG(0xe8005 - code32init_start)
LONG(0xe8019 - code32init_start)
LONG(0xe8028 - code32init_start)
LONG(0xe8068 - code32init_start)
LONG(0xe80a7 - code32init_start)
LONG(0xe80bd - code32init_start)
LONG(0xe80cf - code32init_start)
LONG(0xe80fa - code32init_start)
LONG(0xe8146 - code32init_start)
LONG(0xe81ab - code32init_start)
LONG(0xe81f8 - code32init_start)
LONG(0xe8211 - code32init_start)
LONG(0xe822c - code32init_start)
LONG(0xe8242 - code32init_start)
LONG(0xe8253 - code32init_start)
LONG(0xe825a - code32init_start)
LONG(0xe8270 - code32init_start)
LONG(0xe8283 - code32init_start)
LONG(0xe82a3 - code32init_start)
LONG(0xe82b7 - code32init_start)
LONG(0xe835f - code32init_start)
LONG(0xe83a1 - code32init_start)
LONG(0xe83d4 - code32init_start)
LONG(0xe84c9 - code32init_start)
LONG(0xe8532 - code32init_start)
LONG(0xe859e - code32init_start)
LONG(0xe8647 - code32init_start)
LONG(0xe866f - code32init_start)
LONG(0xe869f - code32init_start)
LONG(0xe86b2 - code32init_start)
LONG(0xe86ea - code32init_start)
LONG(0xe871e - code32init_start)
LONG(0xe8734 - code32init_start)
LONG(0xe874a - code32init_start)
LONG(0xe8754 - code32init_start)
LONG(0xe8767 - code32init_start)
LONG(0xe877c - code32init_start)
LONG(0xe878c - code32init_start)
LONG(0xe87a3 - code32init_start)
LONG(0xe87ad - code32init_start)
LONG(0xe87c3 - code32init_start)
LONG(0xe87cf - code32init_start)
LONG(0xe87e2 - code32init_start)
LONG(0xe87f1 - code32init_start)
LONG(0xe8804 - code32init_start)
LONG(0xe8812 - code32init_start)
LONG(0xe8822 - code32init_start)
LONG(0xe8838 - code32init_start)
LONG(0xe8849 - code32init_start)
LONG(0xe8862 - code32init_start)
LONG(0xe888a - code32init_start)
LONG(0xe889f - code32init_start)
LONG(0xe8a2d - code32init_start)
LONG(0xe8a40 - code32init_start)
LONG(0xe8a69 - code32init_start)
LONG(0xe8a8a - code32init_start)
LONG(0xe8ab0 - code32init_start)
LONG(0xe8ac7 - code32init_start)
LONG(0xe8ae2 - code32init_start)
LONG(0xe8afb - code32init_start)
LONG(0xe8b30 - code32init_start)
LONG(0xe8b96 - code32init_start)
LONG(0xe8bcd - code32init_start)
LONG(0xe8c63 - code32init_start)
LONG(0xe8c94 - code32init_start)
LONG(0xe8ca7 - code32init_start)
LONG(0xe8cb7 - code32init_start)
LONG(0xe8ccd - code32init_start)
LONG(0xe8cdd - code32init_start)
LONG(0xe8d10 - code32init_start)
LONG(0xe8d3a - code32init_start)
LONG(0xe8d6b - code32init_start)
LONG(0xe8d8d - code32init_start)
LONG(0xe8e1e - code32init_start)
LONG(0xe8e2e - code32init_start)
LONG(0xe8e68 - code32init_start)
LONG(0xe8e75 - code32init_start)
LONG(0xe8f84 - code32init_start)
LONG(0xe8f95 - code32init_start)
LONG(0xe901a - code32init_start)
LONG(0xe904b - code32init_start)
LONG(0xe9071 - code32init_start)
LONG(0xe90a0 - code32init_start)
LONG(0xe91a2 - code32init_start)
LONG(0xe91fe - code32init_start)
LONG(0xe9214 - code32init_start)
LONG(0xe9246 - code32init_start)
LONG(0xe92d3 - code32init_start)
LONG(0xe932e - code32init_start)
LONG(0xe933f - code32init_start)
LONG(0xe9358 - code32init_start)
LONG(0xe9385 - code32init_start)
LONG(0xe9394 - code32init_start)
LONG(0xe93ad - code32init_start)
LONG(0xe93be - code32init_start)
LONG(0xe93dd - code32init_start)
LONG(0xe9440 - code32init_start)
LONG(0xe945c - code32init_start)
LONG(0xe946a - code32init_start)
LONG(0xe94a5 - code32init_start)
LONG(0xe94be - code32init_start)
LONG(0xe94f0 - code32init_start)
LONG(0xe952a - code32init_start)
LONG(0xe953b - code32init_start)
LONG(0xe958c - code32init_start)
LONG(0xe9685 - code32init_start)
LONG(0xe970c - code32init_start)
LONG(0xe9798 - code32init_start)
LONG(0xe97b4 - code32init_start)
LONG(0xe97cc - code32init_start)
LONG(0xe97d5 - code32init_start)
LONG(0xe9821 - code32init_start)
LONG(0xe985b - code32init_start)
LONG(0xe98a1 - code32init_start)
LONG(0xe9974 - code32init_start)
LONG(0xe99f7 - code32init_start)
LONG(0xe9a81 - code32init_start)
LONG(0xe9b7c - code32init_start)
LONG(0xe9c2b - code32init_start)
LONG(0xe9c76 - code32init_start)
LONG(0xe9d4a - code32init_start)
LONG(0xe9d58 - code32init_start)
LONG(0xe9da2 - code32init_start)
LONG(0xe9de7 - code32init_start)
LONG(0xe9e51 - code32init_start)
LONG(0xe9f28 - code32init_start)
LONG(0xe9f36 - code32init_start)
LONG(0xe9f99 - code32init_start)
LONG(0xe9fd6 - code32init_start)
LONG(0xea006 - code32init_start)
LONG(0xea12d - code32init_start)
LONG(0xea1b5 - code32init_start)
LONG(0xea1c8 - code32init_start)
LONG(0xea240 - code32init_start)
LONG(0xea2bf - code32init_start)
LONG(0xea2d3 - code32init_start)
LONG(0xea2ea - code32init_start)
LONG(0xea338 - code32init_start)
LONG(0xea3a8 - code32init_start)
LONG(0xea3d1 - code32init_start)
LONG(0xea41d - code32init_start)
LONG(0xea46b - code32init_start)
LONG(0xea47d - code32init_start)
LONG(0xea49a - code32init_start)
LONG(0xea4e4 - code32init_start)
LONG(0xea53a - code32init_start)
LONG(0xea567 - code32init_start)
LONG(0xea576 - code32init_start)
LONG(0xea955 - code32init_start)
LONG(0xea964 - code32init_start)
LONG(0xea9e2 - code32init_start)
LONG(0xeaa2d - code32init_start)
LONG(0xeaa40 - code32init_start)
LONG(0xeaa5b - code32init_start)
LONG(0xeaaa6 - code32init_start)
LONG(0xeab30 - code32init_start)
LONG(0xeab3e - code32init_start)
LONG(0xeab51 - code32init_start)
LONG(0xeab5c - code32init_start)
LONG(0xeab93 - code32init_start)
LONG(0xeabbf - code32init_start)
LONG(0xeace8 - code32init_start)
LONG(0xeba17 - code32init_start)
LONG(0xeba86 - code32init_start)
LONG(0xeba99 - code32init_start)
LONG(0xebadd - code32init_start)
LONG(0xebb56 - code32init_start)
LONG(0xebb8c - code32init_start)
LONG(0xebbaa - code32init_start)
LONG(0xebc11 - code32init_start)
LONG(0xebc42 - code32init_start)
LONG(0xebcb4 - code32init_start)
LONG(0xebccd - code32init_start)
LONG(0xebce9 - code32init_start)
LONG(0xebd06 - code32init_start)
LONG(0xebd1d - code32init_start)
LONG(0xebd32 - code32init_start)
LONG(0xebd3d - code32init_start)
LONG(0xebd50 - code32init_start)
LONG(0xebd6c - code32init_start)
LONG(0xebd87 - code32init_start)
LONG(0xebd9e - code32init_start)
LONG(0xebdbb - code32init_start)
LONG(0xebdd8 - code32init_start)
LONG(0xebdfa - code32init_start)
LONG(0xebe1c - code32init_start)
LONG(0xebe29 - code32init_start)
LONG(0xebf40 - code32init_start)
LONG(0xebf77 - code32init_start)
LONG(0xebfa2 - code32init_start)
LONG(0xebfac - code32init_start)
LONG(0xebfb5 - code32init_start)
LONG(0xec044 - code32init_start)
LONG(0xec06c - code32init_start)
LONG(0xec0f4 - code32init_start)
LONG(0xec13b - code32init_start)
LONG(0xec1b0 - code32init_start)
LONG(0xec1ce - code32init_start)
LONG(0xec1f9 - code32init_start)
LONG(0xec204 - code32init_start)
LONG(0xec258 - code32init_start)
LONG(0xec316 - code32init_start)
LONG(0xec34b - code32init_start)
LONG(0xec364 - code32init_start)
LONG(0xec3dc - code32init_start)
LONG(0xec3ef - code32init_start)
LONG(0xec460 - code32init_start)
LONG(0xec63b - code32init_start)
LONG(0xec6ff - code32init_start)
LONG(0xec746 - code32init_start)
LONG(0xec7b5 - code32init_start)
LONG(0xec7c8 - code32init_start)
LONG(0xec7e9 - code32init_start)
LONG(0xec807 - code32init_start)
LONG(0xec828 - code32init_start)
LONG(0xec88b - code32init_start)
LONG(0xec8a2 - code32init_start)
LONG(0xec8de - code32init_start)
LONG(0xec8f6 - code32init_start)
LONG(0xec94b - code32init_start)
LONG(0xec96d - code32init_start)
LONG(0xec978 - code32init_start)
LONG(0xec99d - code32init_start)
LONG(0xec9c7 - code32init_start)
LONG(0xec9da - code32init_start)
LONG(0xeca00 - code32init_start)
LONG(0xeca13 - code32init_start)
LONG(0xecaf6 - code32init_start)
LONG(0xecb74 - code32init_start)
LONG(0xecb93 - code32init_start)
LONG(0xecba6 - code32init_start)
LONG(0xecbb7 - code32init_start)
LONG(0xecbd2 - code32init_start)
LONG(0xecbe8 - code32init_start)
        _reloc_rel_end = ABSOLUTE(.) ;
        _reloc_init_start = ABSOLUTE(.) ;
LONG(0xf185a - code32flat_start)
LONG(0xfc4f1 - code32flat_start)
LONG(0xfcc81 - code32flat_start)
LONG(0xff071 - code32flat_start)
LONG(0xff077 - code32flat_start)
        _reloc_init_end = ABSOLUTE(.) ;

. = ( 0xe0160 - code32flat_start ) ;
*32flat.*(.data.varlow..)
. = ( 0xe0a00 - code32flat_start ) ;
*32flat.*(.text.hlist_del)
. = ( 0xe0a0f - code32flat_start ) ;
*32flat.*(.text.hlist_add)
. = ( 0xe0a20 - code32flat_start ) ;
*32flat.*(.text.putc_str)
. = ( 0xe0a2e - code32flat_start ) ;
*32flat.*(.text.memcmp)
. = ( 0xe0a4e - code32flat_start ) ;
*32flat.*(.text.strtcpy)
. = ( 0xe0a6f - code32flat_start ) ;
*32flat.*(.text.nullTrailingSpace)
. = ( 0xe0a98 - code32flat_start ) ;
*32flat.*(.text.pci_config_readl)
. = ( 0xe0abb - code32flat_start ) ;
*32flat.*(.text.usb_add_freelist)
. = ( 0xe0ac8 - code32flat_start ) ;
*32flat.*(.text.usb_get_freelist)
. = ( 0xe0ae3 - code32flat_start ) ;
*32flat.*(.text.usb_desc2pipe)
. = ( 0xe0b1e - code32flat_start ) ;
*32flat.*(.text.usb_find_desc)
. = ( 0xe0b65 - code32flat_start ) ;
*32flat.*(.text.uhci_hub_disconnect)
. = ( 0xe0b74 - code32flat_start ) ;
*32flat.*(.text.ohci_hub_detect)
. = ( 0xe0b85 - code32flat_start ) ;
*32flat.*(.text.ohci_hub_disconnect)
. = ( 0xe0b97 - code32flat_start ) ;
*32flat.*(.text.ohci_desc2pipe)
. = ( 0xe0be2 - code32flat_start ) ;
*32flat.*(.text.ehci_hub_disconnect)
. = ( 0xe0bf5 - code32flat_start ) ;
*32flat.*(.text.ehci_desc2pipe)
. = ( 0xe0c99 - code32flat_start ) ;
*32flat.*(.text.ata_extract_version)
. = ( 0xe0cb3 - code32flat_start ) ;
*32flat.*(.text.found_compatibleahci)
. = ( 0xe0cb4 - code32flat_start ) ;
*32flat.*(.text.alloc_new)
. = ( 0xe0d00 - code32flat_start ) ;
*32flat.*(.text.alloc_free)
. = ( 0xe0d19 - code32flat_start ) ;
*32flat.*(.text.alloc_find)
. = ( 0xe0d3a - code32flat_start ) ;
*32flat.*(.text.malloc_getspace)
. = ( 0xe0d74 - code32flat_start ) ;
*32flat.*(.text.calcRamSize)
. = ( 0xe0dc5 - code32flat_start ) ;
*32flat.*(.text.romfile_findprefix)
. = ( 0xe0e01 - code32flat_start ) ;
*32flat.*(.text.add_bev)
. = ( 0xe0e56 - code32flat_start ) ;
*32flat.*(.text.idct)
. = ( 0xe1151 - code32flat_start ) ;
*32flat.*(.text.unlikely.idctqtab)
. = ( 0xe11a4 - code32flat_start ) ;
*32flat.*(.text.pci_find_device)
. = ( 0xe11c9 - code32flat_start ) ;
*32flat.*(.text.xhci_hub_detect)
. = ( 0xe11d8 - code32flat_start ) ;
*32flat.*(.text.xhci_hub_disconnect)
. = ( 0xe11d9 - code32flat_start ) ;
*32flat.*(.text.ipchksum)
. = ( 0xe120c - code32flat_start ) ;
*32flat.*(.text.find_cb_header)
. = ( 0xe1259 - code32flat_start ) ;
*32flat.*(.text.find_cb_subtable)
. = ( 0xe127e - code32flat_start ) ;
*32flat.*(.text.smbios_next)
. = ( 0xe12da - code32flat_start ) ;
*32flat.*(.text.memmove)
. = ( 0xe130a - code32flat_start ) ;
*32flat.*(.text.remove_e820)
. = ( 0xe1337 - code32flat_start ) ;
*32flat.*(.text.tpm20_write_EfiSpecIdEventStruct)
. = ( 0xe143d - code32flat_start ) ;
*32flat.*(.text.usb_get_period.isra.19)
. = ( 0xe145a - code32flat_start ) ;
*32flat.*(.text.getword.isra.27)
. = ( 0xe1477 - code32flat_start ) ;
*32flat.*(.text.readtables)
. = ( 0xe180f - code32flat_start ) ;
*32flat.*(.text.fillbits)
. = ( 0xe1889 - code32flat_start ) ;
*32flat.*(.text.dec_rec2)
. = ( 0xe1990 - code32flat_start ) ;
*32flat.*(.text.tpm_can_show_menu)
. = ( 0xe19c2 - code32flat_start ) ;
*32flat.*(.text.ata_extract_model.constprop.109)
. = ( 0xe19e7 - code32flat_start ) ;
*32flat.*(.text.pic_irqmask_mask.constprop.142)
. = ( 0xe1a00 - code32flat_start ) ;
*32flat.*(.text.getFBSize.isra.12)
. = ( 0xe1a2d - code32flat_start ) ;
*32flat.*(.text.pci_config_maskw.constprop.132)
. = ( 0xe1a64 - code32flat_start ) ;
*32flat.*(.text.rom_reserve)
. = ( 0xe1aa8 - code32flat_start ) ;
*32flat.*(.text.uhci_hub_reset)
. = ( 0xe1ae3 - code32flat_start ) ;
*32flat.*(.text.romfile_find)
. = ( 0xe1b18 - code32flat_start ) ;
*32flat.*(.text.romfile_loadint)
. = ( 0xe1b77 - code32flat_start ) ;
*32flat.*(.text.detect_serial.constprop.122)
. = ( 0xe1bd5 - code32flat_start ) ;
*32flat.*(.text.pci_next)
. = ( 0xe1c43 - code32flat_start ) ;
*32flat.*(.text.wait_threads)
. = ( 0xe1c57 - code32flat_start ) ;
*32flat.*(.text.mutex_lock)
. = ( 0xe1c6e - code32flat_start ) ;
*32flat.*(.text.call16_int10)
. = ( 0xe1c93 - code32flat_start ) ;
*32flat.*(.text.wait_preempt)
. = ( 0xe1cbf - code32flat_start ) ;
*32flat.*(.text.pci_enable_busmaster)
. = ( 0xe1cdd - code32flat_start ) ;
*32flat.*(.text.msleep)
. = ( 0xe1d02 - code32flat_start ) ;
*32flat.*(.text.uhci_hub_detect)
. = ( 0xe1d2c - code32flat_start ) ;
*32flat.*(.text.ehci_hub_reset)
. = ( 0xe1d66 - code32flat_start ) ;
*32flat.*(.text.ehci_hub_detect)
. = ( 0xe1dae - code32flat_start ) ;
*32flat.*(.text.iomemcpy)
. = ( 0xe1df4 - code32flat_start ) ;
*32flat.*(.text.get_keystroke)
. = ( 0xe1e98 - code32flat_start ) ;
*32flat.*(.text.tpm12_get_capability)
. = ( 0xe1f1a - code32flat_start ) ;
*32flat.*(.text.tpm12_read_has_owner)
. = ( 0xe1f4d - code32flat_start ) ;
*32flat.*(.text.tpm12_read_permanent_flags.constprop.144)
. = ( 0xe1f94 - code32flat_start ) ;
*32flat.*(.text.tpm12_enable_tpm.isra.79)
. = ( 0xe1fdc - code32flat_start ) ;
*32flat.*(.text.add_drive)
. = ( 0xe1ffc - code32flat_start ) ;
*32flat.*(.text.deploy_romfile)
. = ( 0xe2041 - code32flat_start ) ;
*32flat.*(.text.insert_e820)
. = ( 0xe20d5 - code32flat_start ) ;
*32flat.*(.text.alloc_new_detail)
. = ( 0xe215b - code32flat_start ) ;
*32flat.*(.text.alloc_add)
. = ( 0xe21ae - code32flat_start ) ;
*32flat.*(.text.ohci_hub_reset)
. = ( 0xe2234 - code32flat_start ) ;
*32flat.*(.text.ahci_port_reset)
. = ( 0xe22c9 - code32flat_start ) ;
*32flat.*(.text.wait_bit)
. = ( 0xe2313 - code32flat_start ) ;
*32flat.*(.text.i8042_command)
. = ( 0xe23d9 - code32flat_start ) ;
*32flat.*(.text.powerup_await_non_bsy)
. = ( 0xe2447 - code32flat_start ) ;
*32flat.*(.text.malloc_pfree)
. = ( 0xe248f - code32flat_start ) ;
*32flat.*(.text.romfile_add)
. = ( 0xe24b8 - code32flat_start ) ;
*32flat.*(.text.find_prio)
. = ( 0xe2533 - code32flat_start ) ;
*32flat.*(.text.xhci_hub_reset)
. = ( 0xe25ed - code32flat_start ) ;
*32flat.*(.text.xhci_cmd_submit)
. = ( 0xe2634 - code32flat_start ) ;
*32flat.*(.text.xhci_cmd_configure_endpoint)
. = ( 0xe2682 - code32flat_start ) ;
*32flat.*(.text.sdcard_pio_app.constprop.135)
. = ( 0xe26be - code32flat_start ) ;
*32flat.*(.text.sdcard_set_frequency)
. = ( 0xe2768 - code32flat_start ) ;
*32flat.*(.text.mbfs_copyfile)
. = ( 0xe27b7 - code32flat_start ) ;
*32flat.*(.text.e820_add)
. = ( 0xe29be - code32flat_start ) ;
*32flat.*(.text.malloc_palloc.part.70)
. = ( 0xe2a22 - code32flat_start ) ;
*32flat.*(.text.malloc_palloc)
. = ( 0xe2a2e - code32flat_start ) ;
*32flat.*(.text.malloc_tmphigh)
. = ( 0xe2a3f - code32flat_start ) ;
*32flat.*(.text.malloc_low)
. = ( 0xe2a50 - code32flat_start ) ;
*32flat.*(.text.create_bounce_buf)
. = ( 0xe2a87 - code32flat_start ) ;
*32flat.*(.text.malloc_fseg)
. = ( 0xe2a98 - code32flat_start ) ;
*32flat.*(.text.init_atadrive)
. = ( 0xe2afc - code32flat_start ) ;
*32flat.*(.text.memalign_high)
. = ( 0xe2b08 - code32flat_start ) ;
*32flat.*(.text.malloc_high)
. = ( 0xe2b19 - code32flat_start ) ;
*32flat.*(.text.memalign_tmp)
. = ( 0xe2b42 - code32flat_start ) ;
*32flat.*(.text.xhci_alloc_inctx)
. = ( 0xe2c2c - code32flat_start ) ;
*32flat.*(.text.malloc_tmp)
. = ( 0xe2c4c - code32flat_start ) ;
*32flat.*(.text.run_thread)
. = ( 0xe2cde - code32flat_start ) ;
*32flat.*(.text.usb_enumerate)
. = ( 0xe2d50 - code32flat_start ) ;
*32flat.*(.text.bootentry_add)
. = ( 0xe2e05 - code32flat_start ) ;
*32flat.*(.text.boot_add_hd)
. = ( 0xe2e23 - code32flat_start ) ;
*32flat.*(.text.boot_add_cd)
. = ( 0xe2e41 - code32flat_start ) ;
*32flat.*(.text.pci_probe_devices)
. = ( 0xe302e - code32flat_start ) ;
*32flat.*(.text.init_floppy)
. = ( 0xe30b5 - code32flat_start ) ;
*32flat.*(.text.init_controller.constprop.108)
. = ( 0xe3152 - code32flat_start ) ;
*32flat.*(.text.send_ata_identity)
. = ( 0xe3200 - code32flat_start ) ;
*32flat.*(.text.ps2_recvbyte.constprop.149)
. = ( 0xe3291 - code32flat_start ) ;
*32flat.*(.text.ps2_sendbyte.constprop.118)
. = ( 0xe32eb - code32flat_start ) ;
*32flat.*(.text.ps2_kbd_command)
. = ( 0xe34f4 - code32flat_start ) ;
*32flat.*(.text.ps2_keyboard_setup)
. = ( 0xe3657 - code32flat_start ) ;
*32flat.*(.text.free)
. = ( 0xe367c - code32flat_start ) ;
*32flat.*(.text.__end_thread)
. = ( 0xe36b4 - code32flat_start ) ;
*32flat.*(.text.ahci_port_release)
. = ( 0xe36e2 - code32flat_start ) ;
*32flat.*(.text.romfile_loadfile)
. = ( 0xe3764 - code32flat_start ) ;
*32flat.*(.text.cbfs_copyfile)
. = ( 0xe3806 - code32flat_start ) ;
*32flat.*(.text.configure_ehci)
. = ( 0xe3a49 - code32flat_start ) ;
*32flat.*(.text.configure_xhci)
. = ( 0xe3d6e - code32flat_start ) ;
*32flat.*(.text.configure_uhci)
. = ( 0xe3f36 - code32flat_start ) ;
*32flat.*(.text.configure_ohci)
. = ( 0xe41a9 - code32flat_start ) ;
*32flat.*(.text.usb_realloc_pipe)
. = ( 0xe4f1e - code32flat_start ) ;
*32flat.*(.text.usb_alloc_pipe)
. = ( 0xe4f27 - code32flat_start ) ;
*32flat.*(.text.usb_free_pipe)
. = ( 0xe4f33 - code32flat_start ) ;
*32flat.*(.text.interface_init)
. = ( 0xe577f - code32flat_start ) ;
*32flat.*(.text.pci_enable_iobar)
. = ( 0xe57e6 - code32flat_start ) ;
*32flat.*(.text.found_genericata)
. = ( 0xe58ac - code32flat_start ) ;
*32flat.*(.text.enable_vga_console)
. = ( 0xe5a3e - code32flat_start ) ;
*32flat.*(.text.tpm12_set_owner_install.constprop.101)
. = ( 0xe5ad7 - code32flat_start ) ;
*32flat.*(.text.tpm12_activate_tpm.constprop.112)
. = ( 0xe5b51 - code32flat_start ) ;
*32flat.*(.text.snprintf)
. = ( 0xe5b9c - code32flat_start ) ;
*32flat.*(.text.bootprio_find_named_rom)
. = ( 0xe5bed - code32flat_start ) ;
*32flat.*(.text.build_usb_path.isra.65)
. = ( 0xe5c2b - code32flat_start ) ;
*32flat.*(.text.build_pci_path.constprop.130)
. = ( 0xe5cd8 - code32flat_start ) ;
*32flat.*(.text.bootprio_find_usb)
. = ( 0xe5d62 - code32flat_start ) ;
*32flat.*(.text.getRomPriority)
. = ( 0xe5dd2 - code32flat_start ) ;
*32flat.*(.text.bootprio_find_ata_device)
. = ( 0xe5e20 - code32flat_start ) ;
*32flat.*(.text.znprintf.constprop.139)
. = ( 0xe5e81 - code32flat_start ) ;
*32flat.*(.text.sdcard_controller_setup.part.76)
. = ( 0xe63fb - code32flat_start ) ;
*32flat.*(.text.sdcard_romfile_setup)
. = ( 0xe6445 - code32flat_start ) ;
*32flat.*(.text.init_optionrom)
. = ( 0xe654f - code32flat_start ) ;
*32flat.*(.text.run_file_roms)
. = ( 0xe65a5 - code32flat_start ) ;
*32flat.*(.text.init_pcirom)
. = ( 0xe683e - code32flat_start ) ;
*32flat.*(.text.optionrom_setup)
. = ( 0xe6a5a - code32flat_start ) ;
*32flat.*(.text.addFloppy)
. = ( 0xe6b00 - code32flat_start ) ;
*32flat.*(.text.pci_enable_membar)
. = ( 0xe6b88 - code32flat_start ) ;
*32flat.*(.text.sdcard_pci_setup)
. = ( 0xe6bd4 - code32flat_start ) ;
*32flat.*(.text.device_hardware_setup)
. = ( 0xe76bf - code32flat_start ) ;
*32flat.*(.text.platform_hardware_setup)
. = ( 0xe80de - code32flat_start ) ;
*32flat.*(.text.ata_detect)
. = ( 0xe851d - code32flat_start ) ;
*32flat.*(.text.usb_send_default_control)
. = ( 0xe853b - code32flat_start ) ;
*32flat.*(.text.get_port_status)
. = ( 0xe8588 - code32flat_start ) ;
*32flat.*(.text.usb_hub_detect)
. = ( 0xe85b2 - code32flat_start ) ;
*32flat.*(.text.set_port_feature)
. = ( 0xe85f6 - code32flat_start ) ;
*32flat.*(.text.usb_hub_disconnect)
. = ( 0xe8653 - code32flat_start ) ;
*32flat.*(.text.usb_hub_reset)
. = ( 0xe8701 - code32flat_start ) ;
*32flat.*(.text.ahci_port_setup)
. = ( 0xe8b87 - code32flat_start ) ;
*32flat.*(.text.ahci_port_detect)
. = ( 0xe8d04 - code32flat_start ) ;
*32flat.*(.text.init..)
. = ( 0xe91e4 - code32flat_start ) ;
*32flat.*(.text.scsi_drive_setup)
. = ( 0xe9412 - code32flat_start ) ;
*32flat.*(.text.megasas_scan_target)
. = ( 0xe9637 - code32flat_start ) ;
*32flat.*(.text.init_megasas)
. = ( 0xe982f - code32flat_start ) ;
*32flat.*(.text.usb_hub_port_setup)
. = ( 0xea1a0 - code32flat_start ) ;
*32flat.*(.text.maininit)
. = ( 0xecc10 - code32flat_start ) ;
*32flat.*(.rodata.maininit)
. = ( 0xecc34 - code32flat_start ) ;
*32flat.*(.rodata.CSWTCH.1375)
. = ( 0xecc48 - code32flat_start ) ;
*32flat.*(.rodata.__func__.13318)
. = ( 0xecc54 - code32flat_start ) ;
*32flat.*(.rodata.__func__.13246)
. = ( 0xecc64 - code32flat_start ) ;
*32flat.*(.rodata.__func__.13233)
. = ( 0xecc74 - code32flat_start ) ;
*32flat.*(.rodata.__func__.13225)
. = ( 0xecc80 - code32flat_start ) ;
*32flat.*(.rodata.__func__.12845)
. = ( 0xecc90 - code32flat_start ) ;
*32flat.*(.rodata.__func__.12858)
. = ( 0xecca0 - code32flat_start ) ;
*32flat.*(.rodata.__func__.12588)
. = ( 0xeccb4 - code32flat_start ) ;
*32flat.*(.rodata.__func__.12572)
. = ( 0xeccc4 - code32flat_start ) ;
*32flat.*(.rodata.__func__.12601)
. = ( 0xeccd8 - code32flat_start ) ;
*32flat.*(.rodata.__func__.12342)
. = ( 0xeccec - code32flat_start ) ;
*32flat.*(.rodata.__func__.12360)
. = ( 0xecd04 - code32flat_start ) ;
*32flat.*(.rodata.__func__.12178)
. = ( 0xecd14 - code32flat_start ) ;
*32flat.*(.rodata.__func__.12001)
. = ( 0xecd30 - code32flat_start ) ;
*32flat.*(.rodata.__func__.12011)
. = ( 0xecd44 - code32flat_start ) ;
*32flat.*(.rodata.__func__.11994)
. = ( 0xecd60 - code32flat_start ) ;
*32flat.*(.rodata.__func__.11980)
. = ( 0xecd78 - code32flat_start ) ;
*32flat.*(.rodata.__func__.11987)
. = ( 0xecd90 - code32flat_start ) ;
*32flat.*(.rodata.__func__.11973)
. = ( 0xecda8 - code32flat_start ) ;
*32flat.*(.rodata.__func__.12035)
. = ( 0xecdb8 - code32flat_start ) ;
*32flat.*(.rodata.__func__.12046)
. = ( 0xecdc8 - code32flat_start ) ;
*32flat.*(.rodata.__func__.12072)
. = ( 0xecddc - code32flat_start ) ;
*32flat.*(.rodata.__func__.11811)
. = ( 0xecde8 - code32flat_start ) ;
*32flat.*(.rodata.__func__.11842)
. = ( 0xecdf8 - code32flat_start ) ;
*32flat.*(.rodata.__func__.11865)
. = ( 0xece08 - code32flat_start ) ;
*32flat.*(.rodata.__func__.11880)
. = ( 0xece20 - code32flat_start ) ;
*32flat.*(.rodata.__func__.11444)
. = ( 0xece30 - code32flat_start ) ;
*32flat.*(.rodata.__func__.11453)
. = ( 0xece44 - code32flat_start ) ;
*32flat.*(.rodata.__func__.11470)
. = ( 0xece54 - code32flat_start ) ;
*32flat.*(.rodata.__func__.11437)
. = ( 0xece64 - code32flat_start ) ;
*32flat.*(.rodata.__func__.11502)
. = ( 0xece7c - code32flat_start ) ;
*32flat.*(.rodata.__func__.11320)
. = ( 0xece90 - code32flat_start ) ;
*32flat.*(.rodata.__func__.11314)
. = ( 0xecea4 - code32flat_start ) ;
*32flat.*(.rodata.__func__.11234)
. = ( 0xeceb8 - code32flat_start ) ;
*32flat.*(.rodata.evt_separator.10844)
. = ( 0xecebc - code32flat_start ) ;
*32flat.*(.rodata.__func__.10781)
. = ( 0xeced0 - code32flat_start ) ;
*32flat.*(.rodata.__func__.9494)
. = ( 0xecee4 - code32flat_start ) ;
*32flat.*(.rodata.__func__.9185)
. = ( 0xecef4 - code32flat_start ) ;
*32flat.*(.rodata.__func__.9072)
. = ( 0xecf04 - code32flat_start ) ;
*32flat.*(.rodata.__func__.8887)
. = ( 0xecf14 - code32flat_start ) ;
*32flat.*(.rodata.__func__.8929)
. = ( 0xecf20 - code32flat_start ) ;
*32flat.*(.rodata.__func__.8905)
. = ( 0xecf30 - code32flat_start ) ;
*32flat.*(.rodata.__func__.8825)
. = ( 0xecf44 - code32flat_start ) ;
*32flat.*(.rodata.__func__.8704)
. = ( 0xecf50 - code32flat_start ) ;
*32flat.*(.rodata.__func__.8633)
. = ( 0xecf58 - code32flat_start ) ;
*32flat.*(.rodata.__func__.8530)
. = ( 0xecf6c - code32flat_start ) ;
*32flat.*(.rodata.__func__.8408)
. = ( 0xecf78 - code32flat_start ) ;
*32flat.*(.rodata.__func__.7973)
. = ( 0xecf88 - code32flat_start ) ;
*32flat.*(.rodata.__func__.7980)
. = ( 0xecf9c - code32flat_start ) ;
*32flat.*(.rodata.__func__.7707)
. = ( 0xecfac - code32flat_start ) ;
*32flat.*(.rodata.__func__.7593)
. = ( 0xecfbc - code32flat_start ) ;
*32flat.*(.rodata.__func__.7623)
. = ( 0xecfd4 - code32flat_start ) ;
*32flat.*(.rodata.__func__.7657)
. = ( 0xecfe4 - code32flat_start ) ;
*32flat.*(.rodata.__func__.7404)
. = ( 0xecff0 - code32flat_start ) ;
*32flat.*(.rodata.__func__.7193)
. = ( 0xecffc - code32flat_start ) ;
*32flat.*(.rodata.__func__.7035)
. = ( 0xed00c - code32flat_start ) ;
*32flat.*(.rodata.__func__.6944)
. = ( 0xed020 - code32flat_start ) ;
*32flat.*(.rodata.__func__.6656)
. = ( 0xed038 - code32flat_start ) ;
*32flat.*(.rodata.__func__.6683)
. = ( 0xed04c - code32flat_start ) ;
*32flat.*(.rodata.__func__.6595)
. = ( 0xed05c - code32flat_start ) ;
*32flat.*(.rodata.__func__.6612)
. = ( 0xed074 - code32flat_start ) ;
*32flat.*(.rodata.__func__.6456)
. = ( 0xed088 - code32flat_start ) ;
*32flat.*(.rodata.__func__.6330)
. = ( 0xed098 - code32flat_start ) ;
*32flat.*(.rodata.__func__.6367)
. = ( 0xed0a4 - code32flat_start ) ;
*32flat.*(.rodata.__func__.6380)
. = ( 0xed0b4 - code32flat_start ) ;
*32flat.*(.rodata.__func__.6394)
. = ( 0xed0cc - code32flat_start ) ;
*32flat.*(.rodata.__func__.6205)
. = ( 0xed0e4 - code32flat_start ) ;
*32flat.*(.rodata.__func__.6231)
. = ( 0xed0f8 - code32flat_start ) ;
*32flat.*(.rodata.__func__.6165)
. = ( 0xed108 - code32flat_start ) ;
*32flat.*(.rodata.__func__.6177)
. = ( 0xed120 - code32flat_start ) ;
*32flat.*(.rodata.__func__.6031)
. = ( 0xed134 - code32flat_start ) ;
*32flat.*(.rodata.__func__.6075)
. = ( 0xed144 - code32flat_start ) ;
*32flat.*(.rodata.__func__.5403)
. = ( 0xed150 - code32flat_start ) ;
*32flat.*(.rodata.__func__.5516)
. = ( 0xed164 - code32flat_start ) ;
*32flat.*(.rodata.__func__.5384)
. = ( 0xed174 - code32flat_start ) ;
*32flat.*(.rodata.__func__.5445)
. = ( 0xed184 - code32flat_start ) ;
*32flat.*(.rodata.mem_power.4867)
. = ( 0xed18c - code32flat_start ) ;
*32flat.*(.rodata.__func__.3676)
. = ( 0xed19c - code32flat_start ) ;
*32flat.*(.rodata.__func__.3423)
. = ( 0xed1a8 - code32flat_start ) ;
*32flat.*(.rodata.__func__.3373)
. = ( 0xed1bc - code32flat_start ) ;
*32flat.*(.rodata.__func__.2928)
. = ( 0xed1c8 - code32flat_start ) ;
*32flat.*(.rodata.speed_to_xhci)
. = ( 0xed1e0 - code32flat_start ) ;
*32flat.*(.rodata.speed_from_xhci)
. = ( 0xed220 - code32flat_start ) ;
*32flat.*(.rodata.Startup_SU_CLEAR)
. = ( 0xed222 - code32flat_start ) ;
*32flat.*(.rodata.CommandFlag_TRUE)
. = ( 0xed223 - code32flat_start ) ;
*32flat.*(.rodata.CommandFlag_FALSE)
. = ( 0xed224 - code32flat_start ) ;
*32flat.*(.rodata.PhysicalPresence_NOT_PRESENT_LOCK)
. = ( 0xed226 - code32flat_start ) ;
*32flat.*(.rodata.PhysicalPresence_PRESENT)
. = ( 0xed228 - code32flat_start ) ;
*32flat.*(.rodata.PhysicalPresence_CMD_ENABLE)
. = ( 0xed22a - code32flat_start ) ;
*32flat.*(.rodata.Startup_ST_CLEAR)
. = ( 0xed240 - code32flat_start ) ;
*32flat.*(.rodata.aaidct)
. = ( 0xed260 - code32flat_start ) ;
*32flat.*(.rodata.zig)
. = ( 0xed2a0 - code32flat_start ) ;
*32flat.*(.rodata.pci_ata_tbl)
. = ( 0xed2dc - code32flat_start ) ;
*32flat.*(.rodata.speed_to_ctlsize)
. = ( 0xed2ec - code32flat_start ) ;
*32flat.*(.data.CBpart)
. = ( 0xed2f0 - code32flat_start ) ;
*32flat.*(.data.CBvendor)
. = ( 0xed2f4 - code32flat_start ) ;
*32flat.*(.data.HubOp)
. = ( 0xed300 - code32flat_start ) ;
*32flat.*(.data.xhci_hub_ops)
. = ( 0xed30c - code32flat_start ) ;
*32flat.*(.data.varinit..)
. = ( 0xed360 - code32flat_start ) ;
*32flat.*(.data.zig2)
. = ( 0xed3a0 - code32flat_start ) ;
*32flat.*(.data.DefaultBEVPrio)
. = ( 0xed3a4 - code32flat_start ) ;
*32flat.*(.data.RomEnd)
. = ( 0xed3a8 - code32flat_start ) ;
*32flat.*(.data.ehci_HubOp)
. = ( 0xed3b4 - code32flat_start ) ;
*32flat.*(.data.ohci_HubOp)
. = ( 0xed3c0 - code32flat_start ) ;
*32flat.*(.data.uhci_HubOp)
. = ( 0xed3cc - code32flat_start ) ;
*32flat.*(.bss.ataid.7655)
. = ( 0xed3d0 - code32flat_start ) ;
*32flat.*(.bss.SMBiosAddr)
. = ( 0xed3d4 - code32flat_start ) ;
*32flat.*(.bss.entry_elf_ebx)
. = ( 0xed3d8 - code32flat_start ) ;
*32flat.*(.bss.entry_elf_eax)
. = ( 0xed3dc - code32flat_start ) ;
*32flat.*(.bss.CBMemTable)
. = ( 0xed3e0 - code32flat_start ) ;
*32flat.*(.bss.TPM_has_physical_presence)
. = ( 0xed3e4 - code32flat_start ) ;
*32flat.*(.bss.BootsplashActive)
. = ( 0xed3e8 - code32flat_start ) ;
*32flat.*(.bss.HaveFDBoot)
. = ( 0xed3ec - code32flat_start ) ;
*32flat.*(.bss.HaveHDBoot)
. = ( 0xed3f0 - code32flat_start ) ;
*32flat.*(.bss.BootorderCount)
. = ( 0xed3f4 - code32flat_start ) ;
*32flat.*(.bss.RunPCIroms)
. = ( 0xed3f8 - code32flat_start ) ;
*32flat.*(.bss.RomBase)
. = ( 0xed3fc - code32flat_start ) ;
*32flat.*(.bss.SpinupEnd)
. = ( 0xed400 - code32flat_start ) ;
*32flat.*(.bss.PendingEHCI)
. = ( 0xed404 - code32flat_start ) ;
*32flat.*(.bss.usb_time_sigatt)
. = ( 0xed408 - code32flat_start ) ;
*32flat.*(.bss.CDCount)
. = ( 0xed420 - code32flat_start ) ;
*32flat.*(.text.switch_next)
. = ( 0xed43d - code32flat_start ) ;
*32flat.*(.text.putc)
. = ( 0xed443 - code32flat_start ) ;
*32flat.*(.text.putsinglehex)
. = ( 0xed456 - code32flat_start ) ;
*32flat.*(.text.puthex)
. = ( 0xed4d9 - code32flat_start ) ;
*32flat.*(.text.putprettyhex)
. = ( 0xed520 - code32flat_start ) ;
*32flat.*(.text.strlen)
. = ( 0xed52f - code32flat_start ) ;
*32flat.*(.text.strcmp)
. = ( 0xed54f - code32flat_start ) ;
*32flat.*(.text.memset)
. = ( 0xed55a - code32flat_start ) ;
*32flat.*(.text.serial_debug)
. = ( 0xed57b - code32flat_start ) ;
*32flat.*(.text.serial_debug_flush)
. = ( 0xed591 - code32flat_start ) ;
*32flat.*(.text.__swab64)
. = ( 0xed5a2 - code32flat_start ) ;
*32flat.*(.text.ahci_port_readl)
. = ( 0xed5b2 - code32flat_start ) ;
*32flat.*(.text.ahci_port_writel)
. = ( 0xed5c8 - code32flat_start ) ;
*32flat.*(.text.debug_putc)
. = ( 0xed5fd - code32flat_start ) ;
*32flat.*(.text.tis_probe)
. = ( 0xed63c - code32flat_start ) ;
*32flat.*(.text.tpm_log_event)
. = ( 0xed6ad - code32flat_start ) ;
*32flat.*(.text.set_timeouts)
. = ( 0xed719 - code32flat_start ) ;
*32flat.*(.text.be32_to_cpu)
. = ( 0xed71c - code32flat_start ) ;
*32flat.*(.text.sha1_block)
. = ( 0xed881 - code32flat_start ) ;
*32flat.*(.text.sha1_do)
. = ( 0xed965 - code32flat_start ) ;
*32flat.*(.text.sha1)
. = ( 0xed99a - code32flat_start ) ;
*32flat.*(.text.tpmhw_transmit)
. = ( 0xeda03 - code32flat_start ) ;
*32flat.*(.text.threads_during_optionroms)
. = ( 0xeda1b - code32flat_start ) ;
*32flat.*(.text.default_process_op.isra.5)
. = ( 0xeda3a - code32flat_start ) ;
*32flat.*(.text.tis_init)
. = ( 0xedaae - code32flat_start ) ;
*32flat.*(.text.scsi_fill_cmd)
. = ( 0xedb0f - code32flat_start ) ;
*32flat.*(.text.pic_reset.constprop.120)
. = ( 0xedb34 - code32flat_start ) ;
*32flat.*(.text.checksum)
. = ( 0xedb47 - code32flat_start ) ;
*32flat.*(.text.tpm_extend)
. = ( 0xedc71 - code32flat_start ) ;
*32flat.*(.text.tpm20_hierarchycontrol.constprop.145)
. = ( 0xedd02 - code32flat_start ) ;
*32flat.*(.text.tpm_build_digest)
. = ( 0xede0e - code32flat_start ) ;
*32flat.*(.text.hash_log_extend.isra.86.part.87)
. = ( 0xedea1 - code32flat_start ) ;
*32flat.*(.text.irqtimer_calc.part.15)
. = ( 0xededd - code32flat_start ) ;
*32flat.*(.text.start_preempt)
. = ( 0xedf18 - code32flat_start ) ;
*32flat.*(.text.timer_read)
. = ( 0xedf8f - code32flat_start ) ;
*32flat.*(.text.timer_check)
. = ( 0xedfa3 - code32flat_start ) ;
*32flat.*(.text.timer_delay)
. = ( 0xedfbe - code32flat_start ) ;
*32flat.*(.text.udelay)
. = ( 0xedfd8 - code32flat_start ) ;
*32flat.*(.text.ndelay.constprop.125)
. = ( 0xedff5 - code32flat_start ) ;
*32flat.*(.text.timer_calc)
. = ( 0xee008 - code32flat_start ) ;
*32flat.*(.text.timer_calc_usec)
. = ( 0xee02c - code32flat_start ) ;
*32flat.*(.text.putuint)
. = ( 0xee075 - code32flat_start ) ;
*32flat.*(.text.bvprintf)
. = ( 0xee357 - code32flat_start ) ;
*32flat.*(.text.panic)
. = ( 0xee372 - code32flat_start ) ;
*32flat.*(.text.call16)
. = ( 0xee3c3 - code32flat_start ) ;
*32flat.*(.text.__call16_int)
. = ( 0xee3e5 - code32flat_start ) ;
*32flat.*(.text.screenc)
. = ( 0xee426 - code32flat_start ) ;
*32flat.*(.text.screen_putc)
. = ( 0xee460 - code32flat_start ) ;
*32flat.*(.text.yield)
. = ( 0xee49a - code32flat_start ) ;
*32flat.*(.text.finish_preempt)
. = ( 0xee4d0 - code32flat_start ) ;
*32flat.*(.text.yield_toirq)
. = ( 0xee4f8 - code32flat_start ) ;
*32flat.*(.text.reset)
. = ( 0xee50b - code32flat_start ) ;
*32flat.*(.text.call16_override)
. = ( 0xee546 - code32flat_start ) ;
*32flat.*(.text.__dprintf)
. = ( 0xee5c4 - code32flat_start ) ;
*32flat.*(.text.debug_banner)
. = ( 0xee5e6 - code32flat_start ) ;
*32flat.*(.text.tpm_build_and_send_cmd)
. = ( 0xee6b1 - code32flat_start ) ;
*32flat.*(.text.tpm_set_failure)
. = ( 0xee6f0 - code32flat_start ) ;
*32flat.*(.text.tpm_add_measurement_to_log)
. = ( 0xee782 - code32flat_start ) ;
*32flat.*(.text.tpm_add_action)
. = ( 0xee7a2 - code32flat_start ) ;
*32flat.*(.text.__warn_noalloc)
. = ( 0xee7b2 - code32flat_start ) ;
*32flat.*(.text.__warn_timeout)
. = ( 0xee7c2 - code32flat_start ) ;
*32flat.*(.text.uhci_waittick)
. = ( 0xee80b - code32flat_start ) ;
*32flat.*(.text.ohci_waittick)
. = ( 0xee853 - code32flat_start ) ;
*32flat.*(.text.ehci_waittick.isra.47)
. = ( 0xee8d1 - code32flat_start ) ;
*32flat.*(.text.await_ide.constprop.127)
. = ( 0xee927 - code32flat_start ) ;
*32flat.*(.text.await_not_bsy)
. = ( 0xee936 - code32flat_start ) ;
*32flat.*(.text.send_cmd)
. = ( 0xee9ee - code32flat_start ) ;
*32flat.*(.text.sdcard_reset)
. = ( 0xeea2c - code32flat_start ) ;
*32flat.*(.text.tis_wait_sts)
. = ( 0xeea86 - code32flat_start ) ;
*32flat.*(.text.tis_activate)
. = ( 0xeeaf3 - code32flat_start ) ;
*32flat.*(.text.tis_find_active_locality)
. = ( 0xeeb19 - code32flat_start ) ;
*32flat.*(.text.tis_readresp)
. = ( 0xeeb56 - code32flat_start ) ;
*32flat.*(.text.tis_waitrespready)
. = ( 0xeeb8d - code32flat_start ) ;
*32flat.*(.text.tis_waitdatavalid)
. = ( 0xeebb7 - code32flat_start ) ;
*32flat.*(.text.tis_ready)
. = ( 0xeebe2 - code32flat_start ) ;
*32flat.*(.text.tis_senddata)
. = ( 0xeec7e - code32flat_start ) ;
*32flat.*(.text.i8042_wait_write)
. = ( 0xeecba - code32flat_start ) ;
*32flat.*(.text.wait_td)
. = ( 0xeed10 - code32flat_start ) ;
*32flat.*(.text.uhci_send_pipe)
. = ( 0xeefc9 - code32flat_start ) ;
*32flat.*(.text.ohci_send_pipe)
. = ( 0xef1b6 - code32flat_start ) ;
*32flat.*(.text.ehci_send_pipe)
. = ( 0xef451 - code32flat_start ) ;
*32flat.*(.text.ata_wait_data)
. = ( 0xef4a2 - code32flat_start ) ;
*32flat.*(.text.megasas_fire_cmd)
. = ( 0xef550 - code32flat_start ) ;
*32flat.*(.text.is_valid_rom)
. = ( 0xef5b9 - code32flat_start ) ;
*32flat.*(.text.call_boot_entry)
. = ( 0xef61b - code32flat_start ) ;
*32flat.*(.text.ahci_command)
. = ( 0xef8b1 - code32flat_start ) ;
*32flat.*(.text.ahci_disk_readwrite_aligned)
. = ( 0xef9d8 - code32flat_start ) ;
*32flat.*(.text.ahci_disk_readwrite)
. = ( 0xefaa5 - code32flat_start ) ;
*32flat.*(.text.xhci_print_port_state)
. = ( 0xefb02 - code32flat_start ) ;
*32flat.*(.text.xhci_trb_queue)
. = ( 0xefbbc - code32flat_start ) ;
*32flat.*(.text.xhci_xfer_queue)
. = ( 0xefc0d - code32flat_start ) ;
*32flat.*(.text.xhci_process_events)
. = ( 0xefd69 - code32flat_start ) ;
*32flat.*(.text.xhci_event_wait)
. = ( 0xefdc1 - code32flat_start ) ;
*32flat.*(.text.xhci_xfer_kick)
. = ( 0xefdf7 - code32flat_start ) ;
*32flat.*(.text.sdcard_waitw)
. = ( 0xefe5f - code32flat_start ) ;
*32flat.*(.text.sdcard_pio)
. = ( 0xefeff - code32flat_start ) ;
*32flat.*(.text.sdcard_pio_transfer)
. = ( 0xf0005 - code32flat_start ) ;
*32flat.*(.text.ulzma)
. = ( 0xf0a7b - code32flat_start ) ;
*32flat.*(.text.find_fadt)
. = ( 0xf0b05 - code32flat_start ) ;
*32flat.*(.text.ata_pio_transfer.constprop.126)
. = ( 0xf0bb8 - code32flat_start ) ;
*32flat.*(.text.printf)
. = ( 0xf0bd9 - code32flat_start ) ;
*32flat.*(.text.boot_fail)
. = ( 0xf0c5a - code32flat_start ) ;
*32flat.*(.text.boot_disk)
. = ( 0xf0d59 - code32flat_start ) ;
*32flat.*(.text.__callrom)
. = ( 0xf0dea - code32flat_start ) ;
*32flat.*(.text.usb_send_pipe)
. = ( 0xf0f24 - code32flat_start ) ;
*32flat.*(.text.usb_process_op)
. = ( 0xf104b - code32flat_start ) ;
*32flat.*(.text.uas_process_op)
. = ( 0xf11c0 - code32flat_start ) ;
*32flat.*(.text.runtime..)
. = ( 0xf1cff - code32flat_start ) ;
*32flat.*(.text.process_op)
. = ( 0xf1d46 - code32flat_start ) ;
*32flat.*(.text.scsi_is_ready)
. = ( 0xf1e61 - code32flat_start ) ;
*32flat.*(.text.cdrom_boot)
. = ( 0xf2188 - code32flat_start ) ;
*32flat.*(.text.do_boot)
. = ( 0xf2428 - code32flat_start ) ;
_rodata32flat = . ;
*32flat.*(.rodata)
. = ( 0xf5408 - code32flat_start ) ;
*32flat.*(.rodata.puthex)
. = ( 0xf5424 - code32flat_start ) ;
*32flat.*(.rodata.runtime..)
. = ( 0xf5444 - code32flat_start ) ;
*32flat.*(.rodata.CSWTCH.1432)
. = ( 0xf5454 - code32flat_start ) ;
*32flat.*(.rodata.__func__.15360)
. = ( 0xf5464 - code32flat_start ) ;
*32flat.*(.rodata.__func__.15324)
. = ( 0xf5474 - code32flat_start ) ;
*32flat.*(.rodata.__func__.12242)
. = ( 0xf5484 - code32flat_start ) ;
*32flat.*(.rodata.__func__.12249)
. = ( 0xf5494 - code32flat_start ) ;
*32flat.*(.rodata.__func__.12126)
. = ( 0xf54a4 - code32flat_start ) ;
*32flat.*(.rodata.__func__.12091)
. = ( 0xf54b4 - code32flat_start ) ;
*32flat.*(.rodata.__func__.12112)
. = ( 0xf54c4 - code32flat_start ) ;
*32flat.*(.rodata.__func__.11931)
. = ( 0xf54d8 - code32flat_start ) ;
*32flat.*(.rodata.__func__.11953)
. = ( 0xf54e8 - code32flat_start ) ;
*32flat.*(.rodata.__func__.11963)
. = ( 0xf54f8 - code32flat_start ) ;
*32flat.*(.rodata.__func__.11384)
. = ( 0xf5508 - code32flat_start ) ;
*32flat.*(.rodata.sha_ko.11188)
. = ( 0xf5518 - code32flat_start ) ;
*32flat.*(.rodata.__func__.10739)
. = ( 0xf5530 - code32flat_start ) ;
*32flat.*(.rodata.__func__.9389)
. = ( 0xf553c - code32flat_start ) ;
*32flat.*(.rodata.__func__.9384)
. = ( 0xf5548 - code32flat_start ) ;
*32flat.*(.rodata.__func__.7945)
. = ( 0xf555c - code32flat_start ) ;
*32flat.*(.rodata.__func__.7378)
. = ( 0xf5568 - code32flat_start ) ;
*32flat.*(.rodata.__func__.6698)
. = ( 0xf5578 - code32flat_start ) ;
*32flat.*(.rodata.__func__.6730)
. = ( 0xf5588 - code32flat_start ) ;
*32flat.*(.rodata.__func__.6567)
. = ( 0xf5598 - code32flat_start ) ;
*32flat.*(.rodata.__func__.6463)
. = ( 0xf55a0 - code32flat_start ) ;
*32flat.*(.rodata.__func__.6483)
. = ( 0xf55b0 - code32flat_start ) ;
*32flat.*(.rodata.__func__.6345)
. = ( 0xf55c0 - code32flat_start ) ;
*32flat.*(.rodata.__func__.6238)
. = ( 0xf55cc - code32flat_start ) ;
*32flat.*(.rodata.__func__.6248)
. = ( 0xf55d4 - code32flat_start ) ;
*32flat.*(.rodata.__func__.6134)
. = ( 0xf55e4 - code32flat_start ) ;
*32flat.*(.rodata.__func__.5393)
. = ( 0xf55f8 - code32flat_start ) ;
*32flat.*(.rodata.tpm_default_durations)
. = ( 0xf5604 - code32flat_start ) ;
*32flat.*(.rodata.tis_default_timeouts)
. = ( 0xf5620 - code32flat_start ) ;
*32flat.*(.rodata.speed_name)
. = ( 0xf5660 - code32flat_start ) ;
*32flat.*(.rodata.TPM2_SelfTest_YES)
. = ( 0xf5661 - code32flat_start ) ;
*32flat.*(.rodata.Startup_SU_STATE)
. = ( 0xf5663 - code32flat_start ) ;
*32flat.*(.rodata.Startup_ST_STATE)
. = ( 0xf5665 - code32flat_start ) ;
*32flat.*(.data.TPMHW_driver_to_use)
. = ( 0xf5680 - code32flat_start ) ;
*32flat.*(.data.tpm_drivers)
. = ( 0xf56b0 - code32flat_start ) ;
*32flat.*(.data.screeninfo)
. = ( 0xf56b4 - code32flat_start ) ;
*32flat.*(.data.debuginfo)
. = ( 0xf56c0 - code32flat_start ) ;
*32flat.*(.data.BUILDINFO)
. = ( 0xf5718 - code32flat_start ) ;
*32flat.*(.data.VERSION)
. = ( 0xf5730 - code32flat_start ) ;
*32flat.*(.bss.tpm_default_to)
. = ( 0xf5740 - code32flat_start ) ;
*32flat.*(.bss.tpm_default_dur)
. = ( 0xf574c - code32flat_start ) ;
*32flat.*(.bss.acpi_reset_val)
. = ( 0xf5750 - code32flat_start ) ;
*32flat.*(.bss.acpi_reset_reg)
. = ( 0xf575c - code32flat_start ) ;
*32flat.*(.bss.RsdpAddr)
. = ( 0xf5760 - code32flat_start ) ;
*32flat.*(.bss.cbcon)
. = ( 0xf5764 - code32flat_start ) ;
*32flat.*(.bss.tpm20_pcr_selection)
. = ( 0xf5768 - code32flat_start ) ;
*32flat.*(.bss.tpm20_pcr_selection_size)
. = ( 0xf576c - code32flat_start ) ;
*32flat.*(.bss.TPM_version)
. = ( 0xf5770 - code32flat_start ) ;
*32flat.*(.bss.BEVCount)
. = ( 0xf5780 - code32flat_start ) ;
*32flat.*(.bss.BEV)
. = ( 0xf5820 - code32flat_start ) ;
*32flat.*(.bss.BootRetryTime)
. = ( 0xf5824 - code32flat_start ) ;
*32flat.*(.bss.VgaROM)
. = ( 0xf5828 - code32flat_start ) ;
*32flat.*(.bss.ScreenAndDebug)
. = ( 0xf582c - code32flat_start ) ;
*32flat.*(.bss.S3ResumeVga)
. = ( 0xf5830 - code32flat_start ) ;
*32flat.*(.bss.EnforceChecksum)
. = ( 0xf5834 - code32flat_start ) ;
*32flat.*(.bss.PreemptCount)
. = ( 0xf5838 - code32flat_start ) ;
*32flat.*(.bss.ThreadControl)
. = ( 0xf5839 - code32flat_start ) ;
*32flat.*(.bss.CanInterrupt)
. = ( 0xf6040 - code32flat_start ) ;
*32flat.*(.data.varfseg..)
. = ( 0xf65c0 - code32flat_start ) ;
*32flat.*(.text.32fseg..)
. = ( 0xf65e8 - code32flat_start ) ;
*32seg.*(.text.set_code_success)
. = ( 0xf65f2 - code32flat_start ) ;
*32seg.*(.text.get_global_offset)
. = ( 0xf65fe - code32flat_start ) ;
*32seg.*(.text.serial_debug)
. = ( 0xf661f - code32flat_start ) ;
*32seg.*(.text.serial_debug_putc)
. = ( 0xf6639 - code32flat_start ) ;
*32seg.*(.text.putsinglehex.isra.0)
. = ( 0xf664c - code32flat_start ) ;
*32seg.*(.text.puthex.isra.1)
. = ( 0xf66d1 - code32flat_start ) ;
*32seg.*(.text.pci_next)
. = ( 0xf673f - code32flat_start ) ;
*32seg.*(.text.putuint.isra.3)
. = ( 0xf6775 - code32flat_start ) ;
*32seg.*(.text.__dprintf)
. = ( 0xf69dd - code32flat_start ) ;
*32seg.*(.text.dump_regs)
. = ( 0xf6a45 - code32flat_start ) ;
*32seg.*(.text.__set_code_invalid)
. = ( 0xf6a75 - code32flat_start ) ;
*32seg.*(.text.handle_pcibios)
. = ( 0xf6dfe - code32flat_start ) ;
*32seg.*(.text.handle_apm)
. = ( 0xf6fa0 - code32flat_start ) ;
_rodata32seg = . ;
*32seg.*(.rodata)
. = ( 0xf7070 - code32flat_start ) ;
*32seg.*(.rodata.__func__.3078)
. = ( 0xf7080 - code32flat_start ) ;
*32seg.*(.rodata.__func__.2982)
. = ( 0xf7090 - code32flat_start ) ;
*32seg.*(.rodata.__func__.2941)
. = ( 0xf70a0 - code32flat_start ) ;
*32seg.*(.rodata.__func__.2914)
. = ( 0xf70b0 - code32flat_start ) ;
*32seg.*(.rodata.__func__.2894)
. = ( 0xf70c0 - code32flat_start ) ;
*16.*(.text.set_a20)
. = ( 0xf70ed - code32flat_start ) ;
*16.*(.text.pic_eoi2)
. = ( 0xf70f5 - code32flat_start ) ;
*16.*(.text.call32_prep)
. = ( 0xf718e - code32flat_start ) ;
*16.*(.text.enqueue_key)
. = ( 0xf71ec - code32flat_start ) ;
*16.*(.text.kbd_set_flag)
. = ( 0xf7247 - code32flat_start ) ;
*16.*(.text.serial_debug_putc)
. = ( 0xf7265 - code32flat_start ) ;
*16.*(.text.ehci_reset_pipe)
. = ( 0xf72ac - code32flat_start ) ;
*16.*(.text.lba2chs)
. = ( 0xf72f6 - code32flat_start ) ;
*16.*(.text.on_extra_stack)
. = ( 0xf731a - code32flat_start ) ;
*16.*(.text.__stack_hop_back)
. = ( 0xf7376 - code32flat_start ) ;
*16.*(.text.default_process_op.isra.2)
. = ( 0xf7397 - code32flat_start ) ;
*16.*(.text.getLCHS)
. = ( 0xf741c - code32flat_start ) ;
*16.*(.text.putsinglehex.isra.13)
. = ( 0xf7433 - code32flat_start ) ;
*16.*(.text.puthex.isra.14)
. = ( 0xf74dd - code32flat_start ) ;
*16.*(.text.puts_cs.isra.17)
. = ( 0xf74fc - code32flat_start ) ;
*16.*(.text.clear_usertimer)
. = ( 0xf7543 - code32flat_start ) ;
*16.*(.text.call32_post)
. = ( 0xf75e1 - code32flat_start ) ;
*16.*(.text.pci_next)
. = ( 0xf766d - code32flat_start ) ;
*16.*(.text.set_usertimer)
. = ( 0xf76ef - code32flat_start ) ;
*16.*(.text.putuint.isra.16)
. = ( 0xf7738 - code32flat_start ) ;
*16.*(.text.timer_read)
. = ( 0xf77e8 - code32flat_start ) ;
*16.*(.text.timer_check)
. = ( 0xf7804 - code32flat_start ) ;
*16.*(.text.timer_delay)
. = ( 0xf7828 - code32flat_start ) ;
*16.*(.text.ndelay.constprop.74)
. = ( 0xf7849 - code32flat_start ) ;
*16.*(.text.timer_calc)
. = ( 0xf7865 - code32flat_start ) ;
*16.*(.text.bvprintf.constprop.85)
. = ( 0xf7af9 - code32flat_start ) ;
*16.*(.text.panic.constprop.81)
. = ( 0xf7b15 - code32flat_start ) ;
*16.*(.text.__dprintf)
. = ( 0xf7b2f - code32flat_start ) ;
*16.*(.text.dump_regs)
. = ( 0xf7bc6 - code32flat_start ) ;
*16.*(.text.__debug_enter)
. = ( 0xf7be8 - code32flat_start ) ;
*16.*(.text.__warn_invalid)
. = ( 0xf7c0e - code32flat_start ) ;
*16.*(.text.__set_invalid)
. = ( 0xf7c22 - code32flat_start ) ;
*16.*(.text.getComAddr)
. = ( 0xf7c72 - code32flat_start ) ;
*16.*(.text.__set_code_invalid)
. = ( 0xf7c98 - code32flat_start ) ;
*16.*(.text.__disk_ret)
. = ( 0xf7cc5 - code32flat_start ) ;
*16.*(.text.disk_1308)
. = ( 0xf7dfc - code32flat_start ) ;
*16.*(.text.disk_1315)
. = ( 0xf7e6a - code32flat_start ) ;
*16.*(.text.__warn_unimplemented)
. = ( 0xf7e90 - code32flat_start ) ;
*16.*(.text.__set_code_unimplemented)
. = ( 0xf7eb6 - code32flat_start ) ;
*16.*(.text.__disk_ret_unimplemented)
. = ( 0xf7eda - code32flat_start ) ;
*16.*(.text.__disk_stub)
. = ( 0xf7f05 - code32flat_start ) ;
*16.*(.text.__warn_timeout)
. = ( 0xf7f1b - code32flat_start ) ;
*16.*(.text.floppy_disable_controller)
. = ( 0xf7f41 - code32flat_start ) ;
*16.*(.text.fill_edd)
. = ( 0xf8171 - code32flat_start ) ;
*16.*(.text.handle_12)
. = ( 0xf8196 - code32flat_start ) ;
*16.*(.text.handle_11)
. = ( 0xf81bb - code32flat_start ) ;
*16.*(.text.handle_05)
. = ( 0xf81c4 - code32flat_start ) ;
*16.*(.text.handle_02)
. = ( 0xf81df - code32flat_start ) ;
*16.*(.text.__call32)
. = ( 0xf824c - code32flat_start ) ;
*16.*(.text.__call32_params.constprop.82)
. = ( 0xf8294 - code32flat_start ) ;
*16.*(.text.usb_poll_intr)
. = ( 0xf85ab - code32flat_start ) ;
*16.*(.text._farcall16)
. = ( 0xf85ec - code32flat_start ) ;
*16.*(.text.__call16_int)
. = ( 0xf85ff - code32flat_start ) ;
*16.*(.text.disk_1346.isra.50)
. = ( 0xf86af - code32flat_start ) ;
*16.*(.text.prockeys)
. = ( 0xf8726 - code32flat_start ) ;
*16.*(.text.procmodkey)
. = ( 0xf8780 - code32flat_start ) ;
*16.*(.text.ramdisk_copy)
. = ( 0xf88e9 - code32flat_start ) ;
*16.*(.text.check_irqs)
. = ( 0xf890b - code32flat_start ) ;
*16.*(.text.rtc_updating)
. = ( 0xf8958 - code32flat_start ) ;
*16.*(.text.ps2_recvbyte)
. = ( 0xf8a29 - code32flat_start ) ;
*16.*(.text.ps2_sendbyte)
. = ( 0xf8ad2 - code32flat_start ) ;
*16.*(.text.ps2_command)
. = ( 0xf8dcc - code32flat_start ) ;
*16.*(.text.set_leds)
. = ( 0xf8e34 - code32flat_start ) ;
*16.*(.text.mouse_15c201)
. = ( 0xf8e8a - code32flat_start ) ;
*16.*(.text.handle_160a)
. = ( 0xf8eea - code32flat_start ) ;
*16.*(.text.uhci_waittick)
. = ( 0xf8f46 - code32flat_start ) ;
*16.*(.text.uhci_send_pipe.constprop.77)
. = ( 0xf9339 - code32flat_start ) ;
*16.*(.text.ehci_send_pipe.constprop.78)
. = ( 0xf9642 - code32flat_start ) ;
*16.*(.text.usb_send_pipe.constprop.76)
. = ( 0xf968f - code32flat_start ) ;
*16.*(.text.usb_process_op)
. = ( 0xf9820 - code32flat_start ) ;
*16.*(.text.uas_process_op)
. = ( 0xf9a39 - code32flat_start ) ;
*16.*(.text.floppy_wait_irq)
. = ( 0xf9aaa - code32flat_start ) ;
*16.*(.text.floppy_enable_controller)
. = ( 0xf9b02 - code32flat_start ) ;
*16.*(.text.floppy_drive_pio)
. = ( 0xf9ba2 - code32flat_start ) ;
*16.*(.text.floppy_dma_cmd)
. = ( 0xf9cd8 - code32flat_start ) ;
*16.*(.text.floppy_drive_readid.constprop.73)
. = ( 0xf9d1e - code32flat_start ) ;
*16.*(.text.floppy_read)
. = ( 0xf9ddc - code32flat_start ) ;
*16.*(.text.floppy_write)
. = ( 0xf9e9a - code32flat_start ) ;
*16.*(.text.floppy_format)
. = ( 0xf9f27 - code32flat_start ) ;
*16.*(.text.await_ide.constprop.75)
. = ( 0xf9f9a - code32flat_start ) ;
*16.*(.text.await_not_bsy)
. = ( 0xf9faa - code32flat_start ) ;
*16.*(.text.send_cmd)
. = ( 0xfa0b1 - code32flat_start ) ;
*16.*(.text.ata_pio_transfer)
. = ( 0xfa21b - code32flat_start ) ;
*16.*(.text.ata_wait_data)
. = ( 0xfa285 - code32flat_start ) ;
*16.*(.text.ata_readwrite)
. = ( 0xfa40f - code32flat_start ) ;
*16.*(.text.process_op)
. = ( 0xfa7ac - code32flat_start ) ;
*16.*(.text.cdemu_read)
. = ( 0xfa9d5 - code32flat_start ) ;
*16.*(.text.disk_1300)
. = ( 0xfaa17 - code32flat_start ) ;
*16.*(.text.basic_access)
. = ( 0xfab76 - code32flat_start ) ;
*16.*(.text.disk_1305)
. = ( 0xfac8f - code32flat_start ) ;
*16.*(.text.extended_access)
. = ( 0xfad7f - code32flat_start ) ;
*16.*(.text.disk_13)
. = ( 0xfb139 - code32flat_start ) ;
*16.*(.text.wait_irq)
. = ( 0xfb159 - code32flat_start ) ;
*16.*(.text.dequeue_key)
. = ( 0xfb255 - code32flat_start ) ;
*16.*(.text.handle_1553)
. = ( 0xfb3dd - code32flat_start ) ;
*16.*(.text.handle_40)
. = ( 0xfb3fc - code32flat_start ) ;
*16.*(.text.handle_13)
. = ( 0xfb4b8 - code32flat_start ) ;
*16.*(.text.invoke_mouse_handler)
. = ( 0xfb531 - code32flat_start ) ;
*16.*(.text.process_mouse)
. = ( 0xfb58c - code32flat_start ) ;
*16.*(.text.handle_16)
. = ( 0xfb6a4 - code32flat_start ) ;
*16.*(.text.handle_1589)
. = ( 0xfb741 - code32flat_start ) ;
*16.*(.text.handle_15)
. = ( 0xfbfcd - code32flat_start ) ;
*16.*(.text.handle_17)
. = ( 0xfc153 - code32flat_start ) ;
*16.*(.text.handle_08)
. = ( 0xfc465 - code32flat_start ) ;
*16.*(.text.handle_70)
. = ( 0xfc55d - code32flat_start ) ;
*16.*(.text.handle_resume)
. = ( 0xfc621 - code32flat_start ) ;
*16.*(.text.handle_pnp)
. = ( 0xfc66a - code32flat_start ) ;
*16.*(.text.handle_pcibios)
. = ( 0xfca2b - code32flat_start ) ;
*16.*(.text.handle_hwpic1)
. = ( 0xfca4d - code32flat_start ) ;
*16.*(.text.handle_hwpic2)
. = ( 0xfca6c - code32flat_start ) ;
*16.*(.text.handle_74)
. = ( 0xfcaa7 - code32flat_start ) ;
*16.*(.text.handle_09)
. = ( 0xfcaf0 - code32flat_start ) ;
*16.*(.text.handle_0e)
. = ( 0xfcb0c - code32flat_start ) ;
*16.*(.text.asm.transition32)
. = ( 0xfcb5a - code32flat_start ) ;
*16.*(.text.asm.transition16)
. = ( 0xfcba8 - code32flat_start ) ;
*16.*(.text.asm.__farcall16)
. = ( 0xfcc35 - code32flat_start ) ;
*16.*(.text.asm.irq_trampoline_0x02)
. = ( 0xfcc38 - code32flat_start ) ;
*16.*(.text.asm.irq_trampoline_0x05)
. = ( 0xfcc3b - code32flat_start ) ;
*16.*(.text.asm.irq_trampoline_0x10)
. = ( 0xfcc3e - code32flat_start ) ;
*16.*(.text.asm.irq_trampoline_0x13)
. = ( 0xfcc41 - code32flat_start ) ;
*16.*(.text.asm.irq_trampoline_0x15)
. = ( 0xfcc44 - code32flat_start ) ;
*16.*(.text.asm.irq_trampoline_0x16)
. = ( 0xfcc47 - code32flat_start ) ;
*16.*(.text.asm.entry_resume)
. = ( 0xfcc5c - code32flat_start ) ;
*16.*(.text.asm.entry_pmm)
. = ( 0xfccba - code32flat_start ) ;
*16.*(.text.asm.entry_pnp_real)
. = ( 0xfcd02 - code32flat_start ) ;
*16.*(.text.asm.entry_apm16)
. = ( 0xfcd43 - code32flat_start ) ;
*16.*(.text.asm.entry_apm32)
. = ( 0xfcd75 - code32flat_start ) ;
*16.*(.text.asm.entry_pcibios32)
. = ( 0xfcda3 - code32flat_start ) ;
*16.*(.text.asm.entry_pcibios16)
. = ( 0xfcddd - code32flat_start ) ;
*16.*(.text.asm.entry_1589)
. = ( 0xfce17 - code32flat_start ) ;
*16.*(.text.asm.entry_bios32)
. = ( 0xfce36 - code32flat_start ) ;
*16.*(.text.asm.irqentry_extrastack)
. = ( 0xfcec3 - code32flat_start ) ;
*16.*(.text.asm.irqentry_arg_extrastack)
. = ( 0xfcf65 - code32flat_start ) ;
*16.*(.text.asm.entry_13)
. = ( 0xfcf6e - code32flat_start ) ;
*16.*(.text.asm.entry_76)
. = ( 0xfcf77 - code32flat_start ) ;
*16.*(.text.asm.entry_70)
. = ( 0xfcf80 - code32flat_start ) ;
*16.*(.text.asm.entry_74)
. = ( 0xfcf89 - code32flat_start ) ;
*16.*(.text.asm.entry_75)
. = ( 0xfcf92 - code32flat_start ) ;
*16.*(.text.asm.entry_hwpic1)
. = ( 0xfcf9b - code32flat_start ) ;
*16.*(.text.asm.entry_hwpic2)
. = ( 0xfcfa4 - code32flat_start ) ;
*16.*(.text.asm.entry_19)
. = ( 0xfcfb7 - code32flat_start ) ;
*16.*(.text.asm.entry_18)
. = ( 0xfcfca - code32flat_start ) ;
_rodata16 = . ;
*16.*(.rodata)
. = ( 0xfd7b0 - code32flat_start ) ;
*16.*(.rodata.__func__.11538)
. = ( 0xfd7c4 - code32flat_start ) ;
*16.*(.rodata.__func__.10772)
. = ( 0xfd7d0 - code32flat_start ) ;
*16.*(.rodata.__func__.10730)
. = ( 0xfd7dc - code32flat_start ) ;
*16.*(.rodata.__func__.10398)
. = ( 0xfd7e8 - code32flat_start ) ;
*16.*(.rodata.__func__.10378)
. = ( 0xfd7f8 - code32flat_start ) ;
*16.*(.rodata.__func__.9403)
. = ( 0xfd808 - code32flat_start ) ;
*16.*(.rodata.__func__.9481)
. = ( 0xfd818 - code32flat_start ) ;
*16.*(.rodata.__func__.7890)
. = ( 0xfd824 - code32flat_start ) ;
*16.*(.rodata.__func__.7983)
. = ( 0xfd82c - code32flat_start ) ;
*16.*(.rodata.__func__.7763)
. = ( 0xfd83c - code32flat_start ) ;
*16.*(.rodata.__func__.6833)
. = ( 0xfd84c - code32flat_start ) ;
*16.*(.rodata.__func__.6894)
. = ( 0xfd85c - code32flat_start ) ;
*16.*(.rodata.__func__.6842)
. = ( 0xfd870 - code32flat_start ) ;
*16.*(.rodata.__func__.6492)
. = ( 0xfd880 - code32flat_start ) ;
*16.*(.rodata.__func__.6396)
. = ( 0xfd890 - code32flat_start ) ;
*16.*(.rodata.__func__.6355)
. = ( 0xfd8a0 - code32flat_start ) ;
*16.*(.rodata.__func__.6328)
. = ( 0xfd8b0 - code32flat_start ) ;
*16.*(.rodata.__func__.6308)
. = ( 0xfd8c0 - code32flat_start ) ;
*16.*(.rodata.__func__.6121)
. = ( 0xfd8d0 - code32flat_start ) ;
*16.*(.rodata.__func__.6117)
. = ( 0xfd8e0 - code32flat_start ) ;
*16.*(.rodata.__func__.6143)
. = ( 0xfd8ec - code32flat_start ) ;
*16.*(.rodata.__func__.5989)
. = ( 0xfd8fc - code32flat_start ) ;
*16.*(.rodata.__func__.5982)
. = ( 0xfd90c - code32flat_start ) ;
*16.*(.rodata.__func__.5971)
. = ( 0xfd918 - code32flat_start ) ;
*16.*(.rodata.__func__.5843)
. = ( 0xfd924 - code32flat_start ) ;
*16.*(.rodata.__func__.5828)
. = ( 0xfd930 - code32flat_start ) ;
*16.*(.rodata.__func__.5815)
. = ( 0xfd93c - code32flat_start ) ;
*16.*(.rodata.__func__.5803)
. = ( 0xfd948 - code32flat_start ) ;
*16.*(.rodata.__func__.5795)
. = ( 0xfd954 - code32flat_start ) ;
*16.*(.rodata.__func__.5724)
. = ( 0xfd960 - code32flat_start ) ;
*16.*(.rodata.__func__.5691)
. = ( 0xfd96c - code32flat_start ) ;
*16.*(.rodata.__func__.5728)
. = ( 0xfd978 - code32flat_start ) ;
*16.*(.rodata.__func__.5660)
. = ( 0xfd984 - code32flat_start ) ;
*16.*(.rodata.__func__.5615)
. = ( 0xfd990 - code32flat_start ) ;
*16.*(.rodata.__func__.5664)
. = ( 0xfd99c - code32flat_start ) ;
*16.*(.rodata.__func__.5570)
. = ( 0xfd9a8 - code32flat_start ) ;
*16.*(.rodata.__func__.5559)
. = ( 0xfd9b8 - code32flat_start ) ;
*16.*(.rodata.__func__.5555)
. = ( 0xfd9c8 - code32flat_start ) ;
*16.*(.rodata.__func__.5470)
. = ( 0xfd9d8 - code32flat_start ) ;
*16.*(.rodata.__func__.5246)
. = ( 0xfd9e4 - code32flat_start ) ;
*16.*(.rodata.__func__.5007)
. = ( 0xfd9f4 - code32flat_start ) ;
*16.*(.rodata.__func__.4974)
. = ( 0xfda04 - code32flat_start ) ;
*16.*(.rodata.__func__.4970)
. = ( 0xfda14 - code32flat_start ) ;
*16.*(.rodata.__func__.4965)
. = ( 0xfda24 - code32flat_start ) ;
*16.*(.rodata.__func__.4960)
. = ( 0xfda34 - code32flat_start ) ;
*16.*(.rodata.__func__.4945)
. = ( 0xfda44 - code32flat_start ) ;
*16.*(.rodata.__func__.4941)
. = ( 0xfda54 - code32flat_start ) ;
*16.*(.rodata.__func__.4933)
. = ( 0xfda64 - code32flat_start ) ;
*16.*(.rodata.__func__.4923)
. = ( 0xfda74 - code32flat_start ) ;
*16.*(.rodata.__func__.4918)
. = ( 0xfda84 - code32flat_start ) ;
*16.*(.rodata.__func__.4905)
. = ( 0xfda94 - code32flat_start ) ;
*16.*(.rodata.__func__.4900)
. = ( 0xfdaa4 - code32flat_start ) ;
*16.*(.rodata.__func__.4889)
. = ( 0xfdab4 - code32flat_start ) ;
*16.*(.rodata.__func__.4804)
. = ( 0xfdac0 - code32flat_start ) ;
*16.*(.rodata.__func__.4725)
. = ( 0xfdacc - code32flat_start ) ;
*16.*(.rodata.__func__.4720)
. = ( 0xfdad8 - code32flat_start ) ;
*16.*(.rodata.__func__.4715)
. = ( 0xfdae4 - code32flat_start ) ;
*16.*(.rodata.__func__.4710)
. = ( 0xfdaf0 - code32flat_start ) ;
*16.*(.rodata.__func__.4705)
. = ( 0xfdafc - code32flat_start ) ;
*16.*(.rodata.__func__.4700)
. = ( 0xfdb08 - code32flat_start ) ;
*16.*(.rodata.__func__.4695)
. = ( 0xfdb14 - code32flat_start ) ;
*16.*(.rodata.__func__.4669)
. = ( 0xfdb20 - code32flat_start ) ;
*16.*(.rodata.__func__.4654)
. = ( 0xfdb2c - code32flat_start ) ;
*16.*(.rodata.__func__.4649)
. = ( 0xfdb38 - code32flat_start ) ;
*16.*(.rodata.__func__.4627)
. = ( 0xfdb44 - code32flat_start ) ;
*16.*(.rodata.__func__.4605)
. = ( 0xfdb50 - code32flat_start ) ;
*16.*(.rodata.__func__.4659)
. = ( 0xfdb5c - code32flat_start ) ;
*16.*(.rodata.__func__.4410)
. = ( 0xfdb6c - code32flat_start ) ;
*16.*(.rodata.__func__.4577)
. = ( 0xfdb78 - code32flat_start ) ;
*16.*(.rodata.__func__.4572)
. = ( 0xfdb84 - code32flat_start ) ;
*16.*(.rodata.__func__.4562)
. = ( 0xfdb90 - code32flat_start ) ;
*16.*(.rodata.__func__.4557)
. = ( 0xfdb9c - code32flat_start ) ;
*16.*(.rodata.__func__.4552)
. = ( 0xfdba8 - code32flat_start ) ;
*16.*(.rodata.__func__.4547)
. = ( 0xfdbb4 - code32flat_start ) ;
*16.*(.rodata.__func__.4540)
. = ( 0xfdbc0 - code32flat_start ) ;
*16.*(.rodata.__func__.4535)
. = ( 0xfdbcc - code32flat_start ) ;
*16.*(.rodata.__func__.4530)
. = ( 0xfdbd8 - code32flat_start ) ;
*16.*(.rodata.__func__.4508)
. = ( 0xfdbe4 - code32flat_start ) ;
*16.*(.rodata.__func__.4464)
. = ( 0xfdbf0 - code32flat_start ) ;
*16.*(.rodata.__func__.4388)
. = ( 0xfdc00 - code32flat_start ) ;
*16.*(.rodata.__func__.4432)
. = ( 0xfdc0c - code32flat_start ) ;
*16.*(.rodata.__func__.4740)
. = ( 0xfdc18 - code32flat_start ) ;
*16.*(.rodata.__func__.4809)
. = ( 0xfdc2c - code32flat_start ) ;
*16.*(.rodata.__func__.4816)
. = ( 0xfdc38 - code32flat_start ) ;
*16.*(.rodata.__func__.1906)
. = ( 0xfdc44 - code32flat_start ) ;
*16.*(.rodata.__func__.1893)
. = ( 0xfdc50 - code32flat_start ) ;
*16.*(.rodata.__func__.1885)
. = ( 0xfdc5c - code32flat_start ) ;
*16.*(.rodata.__func__.1876)
. = ( 0xfdc68 - code32flat_start ) ;
*16.*(.rodata.__func__.1867)
. = ( 0xfdc80 - code32flat_start ) ;
*16.*(.data16..)
. = ( 0xfe05b - code32flat_start ) ;
*16.*(.fixedaddr.0xe05b)
. = ( 0xfe079 - code32flat_start ) ;
*16.*(.text.handle_14)
. = ( 0xfe2b2 - code32flat_start ) ;
*16.*(.text.handle_76)
. = ( 0xfe2c3 - code32flat_start ) ;
*16.*(.fixedaddr.0xe2c3)
. = ( 0xfe2e8 - code32flat_start ) ;
*16.*(.text.i8042_command)
. = ( 0xfe3f1 - code32flat_start ) ;
*16.*(.text.set_code_success)
. = ( 0xfe3fe - code32flat_start ) ;
*16.*(.fixedaddr.0xe3fe)
. = ( 0xfe401 - code32flat_start ) ;
*32flat.*(.fixedaddr.0xe401)
. = ( 0xfe411 - code32flat_start ) ;
*16.*(.text.handle_1a)
. = ( 0xfe6d7 - code32flat_start ) ;
*16.*(.text.serial_debug_flush)
. = ( 0xfe6f2 - code32flat_start ) ;
*16.*(.fixedaddr.0xe6f2)
. = ( 0xfe6f5 - code32flat_start ) ;
*32flat.*(.fixedaddr.0xe6f5)
. = ( 0xfe6ff - code32flat_start ) ;
*16.*(.text.serial_debug)
. = ( 0xfe729 - code32flat_start ) ;
*32flat.*(.fixedaddr.0xe729)
. = ( 0xfe739 - code32flat_start ) ;
*16.*(.fixedaddr.0xe739)
. = ( 0xfe742 - code32flat_start ) ;
*16.*(.text.mouse_command)
. = ( 0xfe81f - code32flat_start ) ;
*16.*(.text.memset)
. = ( 0xfe82e - code32flat_start ) ;
*16.*(.fixedaddr.0xe82e)
. = ( 0xfe837 - code32flat_start ) ;
*16.*(.text.floppy_pio)
. = ( 0xfe981 - code32flat_start ) ;
*16.*(.text.asm.irq_trampoline_0x1b)
. = ( 0xfe984 - code32flat_start ) ;
*16.*(.text.asm.irq_trampoline_0x19)
. = ( 0xfe987 - code32flat_start ) ;
*16.*(.fixedaddr.0xe987)
. = ( 0xfe990 - code32flat_start ) ;
*16.*(.text.megasas_process_op)
. = ( 0xfec56 - code32flat_start ) ;
*16.*(.text.asm.irq_trampoline_0x18)
. = ( 0xfec59 - code32flat_start ) ;
*16.*(.fixedaddr.0xec59)
. = ( 0xfec62 - code32flat_start ) ;
*16.*(.text.floppy_prep)
. = ( 0xfef0c - code32flat_start ) ;
*16.*(.text.i8042_wait_write)
. = ( 0xfef57 - code32flat_start ) ;
*16.*(.fixedaddr.0xef57)
. = ( 0xfef60 - code32flat_start ) ;
*16.*(.text.handle_75)
. = ( 0xfefc7 - code32flat_start ) ;
*32flat.*(.fixedaddr.0xefc7)
. = ( 0xfefd2 - code32flat_start ) ;
*16.*(.fixedaddr.0xefd2)
. = ( 0xfefdb - code32flat_start ) ;
*16.*(.text.scsi_fill_cmd)
. = ( 0xff045 - code32flat_start ) ;
*16.*(.fixedaddr.0xf045)
. = ( 0xff046 - code32flat_start ) ;
*16.*(.text.udelay)
. = ( 0xff065 - code32flat_start ) ;
*16.*(.fixedaddr.0xf065)
. = ( 0xff06e - code32flat_start ) ;
*16.*(.text.asm.entry_elf)
. = ( 0xff0a4 - code32flat_start ) ;
*32flat.*(.fixedaddr.0xf0a4)
. = ( 0xff0fc - code32flat_start ) ;
*16.*(.text.process_key)
. = ( 0xff4f6 - code32flat_start ) ;
*16.*(.text.fill_generic_edd)
. = ( 0xff818 - code32flat_start ) ;
*16.*(.text.timer_sleep)
. = ( 0xff841 - code32flat_start ) ;
*16.*(.fixedaddr.0xf841)
. = ( 0xff84a - code32flat_start ) ;
*16.*(.text.handle_apm)
. = ( 0xff84d - code32flat_start ) ;
*16.*(.fixedaddr.0xf84d)
. = ( 0xff856 - code32flat_start ) ;
*16.*(.text.asm.irq_trampoline_0x4a)
. = ( 0xff859 - code32flat_start ) ;
*16.*(.fixedaddr.0xf859)
. = ( 0xff869 - code32flat_start ) ;
*16.*(.text.ata_atapi_process_op)
. = ( 0xffa2e - code32flat_start ) ;
*16.*(.text.call16_helper)
. = ( 0xffa6e - code32flat_start ) ;
*32flat.*(.fixedaddr.0xfa6e)
. = ( 0xffe6e - code32flat_start ) ;
*16.*(.fixedaddr.0xfe6e)
. = ( 0xffe7e - code32flat_start ) ;
*16.*(.text.rtc_setup)
. = ( 0xffea5 - code32flat_start ) ;
*16.*(.fixedaddr.0xfea5)
. = ( 0xffeae - code32flat_start ) ;
*16.*(.text.disk_1310)
. = ( 0xffef3 - code32flat_start ) ;
*32flat.*(.fixedaddr.0xfef3)
. = ( 0xfff00 - code32flat_start ) ;
*16.*(.text.getLptAddr)
. = ( 0xfff51 - code32flat_start ) ;
*16.*(.text.handle_10)
. = ( 0xfff53 - code32flat_start ) ;
*16.*(.fixedaddr.0xff53)
. = ( 0xfff54 - code32flat_start ) ;
*16.*(.fixedaddr.0xff54)
. = ( 0xfff5d - code32flat_start ) ;
*16.*(.text.handle_legacy_disk)
. = ( 0xfffed - code32flat_start ) ;
*16.*(.text.asm.irq_trampoline_0x1c)
. = ( 0xffff0 - code32flat_start ) ;
*16.*(.fixedaddr.0xfff0)
. = ( 0xffff5 - code32flat_start ) ;
*32flat.*(.fixedaddr.0xfff5)
. = ( 0xffffe - code32flat_start ) ;
*32flat.*(.fixedaddr.0xfffe)
. = ( 0xfffff - code32flat_start ) ;
*32flat.*(.fixedaddr.0xffff)

        code32flat_end = ABSOLUTE(.) ;
    } :text


        /* Discard regular data sections to force a link error if
         * code attempts to access data not marked with VAR16 (or other
         * appropriate macro)
         */
        /DISCARD/ : {
                *(.text*) *(.data*) *(.bss*) *(.rodata*)
                *(COMMON) *(.discard*) *(.eh_frame) *(.note*)
                }
}

ENTRY(entry_elf)
PHDRS
{
        text PT_LOAD AT ( code32flat_start ) ;
}
